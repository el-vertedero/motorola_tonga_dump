/dts-v1/;

/ {

	fragment@channel-id {
		target-path = "/";

		__overlay__ {
			channel-id-map = "acg\0amxbr\0amxpr\0amxmx\0amxcl\0amxar\0amxla\0amxpe\0amxco\0tefbr\0tefmx\0tefar\0tefcl\0tefpe\0tefco\0perar\0entcl\0iusmx\0niibr\0niicl\0niimx\0niipe\0oibr\0timbr\0tigco\0retbr\0retar\0retla\0retcl\0tefla\0retla1st\0tefunl\0tigca\0tigca1st\0retmx\0attmx\0womcl\0avaco\0retpe\0openla\0opencl\0openmx\0altmx\0openpe\0undefined\0undefined\0undefined\0undefined\0undefined\0undefined\0undefined\0undefined\0undefined\0undefined\0undefined\0undefined\0undefined\0undefined\0undefined\0undefined\0undefined\0undefined\0undefined\0undefined\0reteu\0retgb\0retfr\0retes\0retie\0retde\0vfgb\0vfde\0vffr\0o2gb\0o2de\0orafr\0bouyfr\0eegb\0tescogb\0yoigo\0oraes\0retapac\0retmea\0vfit\0vfes\0vfeu\03gb\0tescoie\0altfr\03ie\0altpt\0timit\0retma\0windit\0vfhu\0vfro\0telhu\0playpl\0oraeu\0dteu\0teleu\0pluspl\0dtpl\0tefes\0altice\0vipeu\0veoneu\0openeu\0reteu2\0undefined\0undefined\0undefined\0undefined\0undefined\0undefined\0undefined\0undefined\0undefined\0undefined\0undefined\0undefined\0undefined\0undefined\0undefined\0undefined\0undefined\0undefined\0undefined\0retca\0bwaca\0tkpca\0vzw\0att\0tmo\0sprint\0repw\0attpre\0cricket\0cc\0usc\0tracfone\0retus\0metropcs\0rcica\0wndca\0dmc\0bby\0amz\0acg\0lra\0comcast\0fi\0vzwpre\0boost\0undefined\0undefined\0undefined\0undefined\0undefined\0undefined\0undefined\0undefined\0undefined\0undefined\0undefined\0undefined\0undefined\0undefined\0undefined\0undefined\0undefined\0undefined\0undefined\0undefined\0undefined\0undefined\0undefined\0undefined\0undefined\0undefined\0undefined\0undefined\0undefined\0undefined\0undefined\0undefined\0undefined\0undefined\0undefined\0undefined\0undefined\0undefined\0retin\0retcn\0telstra\0vfau\0amzin\0jioin\0airin\0retid\0cmcc\0ctcn\0cucn\0retmm\0gt4gtw\0retth\0retru\0trueth\0smarthk\0mobilpk\0retsea\0retjp\0softbank\0optus\0retkr\0undefined\0undefined\0undefined\0undefined\0undefined\0undefined\0undefined\0undefined\0undefined\0undefined\0undefined\0undefined\0undefined\0undefined\0undefined\0undefined\0undefined\0undefined\0undefined\0undefined\0undefined\0undefined\0undefined\0undefined\0undefined\0undefined\0undefined\0undefined\0undefined\0undefined\0undefined\0undefined\0undefined\0undefined\0undefined\0undefined\0undefined\0undefined\0undefined\0undefined\0undefined";
		};
	};

	fragment@0 {
		target = <0xffffffff>;

		__overlay__ {

			utags {
				compatible = "mmi,utags";
				mmi,main-utags = "/dev/block/by-name/utags";
				mmi,backup-utags = "/dev/block/by-name/utagsBackup";
			};

			hw {
				compatible = "mmi,utags";
				mmi,dir-name = "hw";
				mmi,main-utags = "/dev/block/by-name/hw";
			};
		};
	};

	fragment@1 {
		target = <0xffffffff>;

		__overlay__ {
			atag,videolfb-fb_base_h = <0x00>;
			atag,videolfb-fb_base_l = "^`P";
			atag,videolfb-islcmfound = <0x01>;
			atag,videolfb-islcm_inited = <0x00>;
			atag,videolfb-fps = <0x1770>;
			atag,videolfb-vramSize = <0x17bb000>;
			atag,videolfb-lcmname = "nt35695B_fhd_dsi_cmd_auo_rt5081_drv";
		};
	};

	fragment@2 {
		target = <0xffffffff>;

		__overlay__ {

			led@0 {
				compatible = "mediatek,red";
				led_mode = <0x00>;
				data = <0x01>;
				pwm_config = <0x00 0x00 0x00 0x00 0x00>;
				phandle = <0x4e>;
			};

			led@1 {
				compatible = "mediatek,green";
				led_mode = <0x00>;
				data = <0x01>;
				pwm_config = <0x00 0x00 0x00 0x00 0x00>;
				phandle = <0x4f>;
			};

			led@2 {
				compatible = "mediatek,blue";
				led_mode = <0x00>;
				data = <0x01>;
				pwm_config = <0x00 0x00 0x00 0x00 0x00>;
				phandle = <0x50>;
			};

			led@3 {
				compatible = "mediatek,jogball-backlight";
				led_mode = <0x00>;
				data = <0x01>;
				pwm_config = <0x00 0x00 0x00 0x00 0x00>;
				phandle = <0x51>;
			};

			led@4 {
				compatible = "mediatek,keyboard-backlight";
				led_mode = <0x00>;
				data = <0x01>;
				pwm_config = <0x00 0x00 0x00 0x00 0x00>;
				phandle = <0x52>;
			};

			led@5 {
				compatible = "mediatek,button-backlight";
				led_mode = <0x00>;
				data = <0x01>;
				pwm_config = <0x00 0x00 0x00 0x00 0x00>;
				phandle = <0x53>;
			};

			led@6 {
				compatible = "mediatek,lcd-backlight";
				led_mode = <0x04>;
				data = <0x01>;
				pwm_config = <0x00 0x03 0x00 0x00 0x00>;
				max-brightness = <0x666>;
				phandle = <0x54>;
			};

			vibrator@0 {
				compatible = "mediatek,vibrator";
				vib_timer = <0x19>;
				vib_limit = <0x09>;
				vib_vol = <0x09>;
				phandle = <0x55>;
			};
		};
	};

	fragment@3 {
		target = <0xffffffff>;

		__overlay__ {

			ext_buck_lp4@57 {
				regulator-name = "ext_buck_vdd2";
				regulator-min-microvolt = <0x493e0>;
				regulator-max-microvolt = <0x13d620>;
				vsel_pin = <0x00>;
			};

			ext_buck_lp4x@50 {
				regulator-name = "ext_buck_vddq";
				regulator-min-microvolt = <0x493e0>;
				regulator-max-microvolt = <0x13d620>;
				vsel_pin = <0x01>;
			};
		};
	};

	fragment@4 {
		target = <0xffffffff>;

		__overlay__ {
			status = "ok";

			ext_buck_vgpu@55 {
				regulator-name = "ext_buck_vgpu";
				regulator-min-microvolt = <0x493e0>;
				regulator-max-microvolt = <0x13d620>;
				vsel_pin = <0x02>;
			};

			abov_sar@20 {
				status = "ok";
				compatible = "abov,abov_sar_mmi_overlay_7ch";
				reg = <0x20>;
				cap_vdd-supply = <0xffffffff>;
				interrupt-parent = <0xffffffff>;
				interrupts = <0x01 0x02 0x01 0x00>;
				abov,irq-gpio-std = <0xffffffff 0x0c 0x00>;
				reg_array_len = <0x03>;
				reg_array_val = <0x07 0x00 0x08 0x1f 0xfb 0x01>;
				cap,use_channel_ch0 = <0x00>;
				cap,use_channel_ch1 = <0x01>;
				cap,use_channel_ch2 = <0x02>;
				ch0_name = "capsense_bottom";
				ch1_name = "capsense_top_left";
				ch2_name = "capsense_top_right";
				label = "AbovCapSense";
				cap,channel_number = <0x03>;
				cap,fw_mode_ret = <0x39>;
				button_mask = <0x15>;
				cap,flash_erase_time = <0x578>;
			};
		};
	};

	fragment@5 {
		target = <0xffffffff>;

		__overlay__ {

			consys_default {
				phandle = <0x01>;
			};

			gpslna@0 {
				phandle = <0x02>;

				pins_cmd_dat {
					pinmux = <0x5b00>;
					slew-rate = <0x00>;
					bias-disable;
					output-low;
				};
			};

			gpslna@1 {
				phandle = <0x03>;

				pins_cmd_dat {
					pinmux = <0x5b00>;
					slew-rate = <0x01>;
					output-high;
				};
			};

			gpslna@2 {
				phandle = <0x04>;

				pins_cmd_dat {
					pinmux = <0x5b00>;
					slew-rate = <0x01>;
					output-low;
				};
			};
		};
	};

	fragment@6 {
		target = <0xffffffff>;

		__overlay__ {
			pinctrl-names = "default\0gps_lna_state_init\0gps_lna_state_oh\0gps_lna_state_ol";
			pinctrl-0 = <0x01>;
			pinctrl-1 = <0x02>;
			pinctrl-2 = <0x03>;
			pinctrl-3 = <0x04>;
			status = "okay";
		};
	};

	fragment@7 {
		target = <0xffffffff>;

		__overlay__ {
			pinctrl-names = "default";
			pinctrl-0 = <0x05>;
		};
	};

	fragment@8 {
		target = <0xffffffff>;

		__overlay__ {

			kpdgpiodefault {
				phandle = <0x05>;

				pins_cmd_dat {
					pinmux = <0x5d01>;
					bias-pull-up = <0x66>;
					output-low;
					input-schmitt-enable;
				};
			};
		};
	};

	fragment@9 {
		target = <0xffffffff>;

		__overlay__ {
			accdet-mic-vol = <0x06>;
			headset-mode-setting = <0x500 0x500 0x01 0x1f0 0x800 0x800 0x20 0x44>;
			accdet-plugout-debounce = <0x01>;
			accdet-mic-mode = <0x01>;
			headset-eint-level-pol = <0x08>;
			headset-three-key-threshold = <0x00 0x50 0xdc 0x190>;
			headset-three-key-threshold-CDD = <0x00 0x79 0xc0 0x258>;
			headset-four-key-threshold = <0x00 0x3a 0x79 0xc0 0x190>;
			pinctrl-names = "default\0state_eint_as_int";
			pinctrl-0 = <0x06>;
			pinctrl-1 = <0x07>;
			status = "okay";
		};
	};

	fragment@10 {
		target = <0xffffffff>;

		__overlay__ {

			accdetdefault {
				phandle = <0x06>;
			};

			accdeteint@0 {
				phandle = <0x07>;

				pins_cmd_dat {
					pinmux = <0x900>;
					slew-rate = <0x00>;
					bias-disable;
				};
			};
		};
	};

	fragment@11 {
		target = <0xffffffff>;

		__overlay__ {
			pinctrl-names = "irtx_gpio_led_default\0irtx_gpio_led_set";
			pinctrl-0 = <0x08>;
			pinctrl-1 = <0x09>;
			status = "okay";
		};
	};

	fragment@12 {
		target = <0xffffffff>;

		__overlay__ {

			irtx_gpio_led_def@gpio90 {
				phandle = <0x08>;

				pins_cmd_dat {
					pinmux = <0x5a00>;
					slew-rate = <0x01>;
					bias-disable;
					output-low;
					input-schmitt-enable = <0x00>;
				};
			};

			irtx_gpio_led_set@gpio90 {
				phandle = <0x09>;

				pins_cmd_dat {
					pinmux = <0x5a02>;
					slew-rate = <0x01>;
					output-high;
				};
			};
		};
	};

	fragment@13 {
		target = <0xffffffff>;

		__overlay__ {
			pinctrl-names = "aud_clk_mosi_off\0aud_clk_mosi_on\0aud_clk_miso_off\0aud_clk_miso_on\0aud_dat_mosi_off\0aud_dat_mosi_on\0aud_dat_miso_off\0aud_dat_miso_on\0aud_smartpa_off\0aud_smartpa_on";
			pinctrl-0 = <0x0a>;
			pinctrl-1 = <0x0b>;
			pinctrl-2 = <0x0c>;
			pinctrl-3 = <0x0d>;
			pinctrl-4 = <0x0e>;
			pinctrl-5 = <0x0f>;
			pinctrl-6 = <0x10>;
			pinctrl-7 = <0x11>;
			pinctrl-8 = <0x12>;
			pinctrl-9 = <0x13>;
			status = "okay";
		};
	};

	fragment@14 {
		target = <0xffffffff>;

		__overlay__ {

			aud_clk_mosi_off {
				phandle = <0x0a>;

				pins_cmd0_dat {
					pinmux = <0x8800>;
				};
			};

			aud_clk_mosi_on {
				phandle = <0x0b>;

				pins_cmd0_dat {
					pinmux = <0x8801>;
				};
			};

			aud_clk_miso_off {
				phandle = <0x0c>;

				pins_cmd0_dat {
					pinmux = <0x8c00>;
				};
			};

			aud_clk_miso_on {
				phandle = <0x0d>;

				pins_cmd0_dat {
					pinmux = <0x8c01>;
				};
			};

			aud_dat_mosi_off {
				phandle = <0x0e>;

				pins_cmd1_dat {
					pinmux = <0x8a00>;
					input-enable;
					slew-rate = <0x00>;
					bias-disable;
				};

				pins_cmd2_dat {
					pinmux = <0x8b00>;
					input-enable;
					slew-rate = <0x00>;
					bias-disable;
				};
			};

			aud_dat_mosi_on {
				phandle = <0x0f>;

				pins_cmd1_dat {
					pinmux = <0x8a01>;
				};

				pins_cmd2_dat {
					pinmux = <0x8b01>;
				};
			};

			aud_dat_miso_off {
				phandle = <0x10>;

				pins_cmd1_dat {
					pinmux = <0x8e00>;
					input-enable;
					slew-rate = <0x00>;
					bias-disable;
				};

				pins_cmd2_dat {
					pinmux = <0x8f00>;
					input-enable;
					slew-rate = <0x00>;
					bias-disable;
				};
			};

			aud_dat_miso_on {
				phandle = <0x11>;

				pins_cmd1_dat {
					pinmux = <0x8e01>;
				};

				pins_cmd2_dat {
					pinmux = <0x8f01>;
				};
			};

			aud_pins_smartpa_off {
				phandle = <0x12>;

				pins_cmd0_dat {
					pinmux = <0x1100>;
				};

				pins_cmd1_dat {
					pinmux = <0x1200>;
				};

				pins_cmd2_dat {
					pinmux = <0x1300>;
				};

				pins_cmd3_dat {
					pinmux = <0x1400>;
				};
			};

			aud_pins_smartpa_on {
				phandle = <0x13>;

				pins_cmd0_dat {
					pinmux = <0x1106>;
				};

				pins_cmd1_dat {
					pinmux = <0x1206>;
				};

				pins_cmd2_dat {
					pinmux = <0x1306>;
				};

				pins_cmd3_dat {
					pinmux = <0x1406>;
				};
			};
		};
	};

	fragment@15 {
		target = <0xffffffff>;

		__overlay__ {
			mt6370,intr_gpio_num = <0x0b>;
			mt6370,intr_gpio = <0xffffffff 0x0b 0x00>;
		};
	};

	fragment@16 {
		target = <0xffffffff>;

		__overlay__ {
			mt6370pd,intr_gpio_num = <0x29>;
			mt6370pd,intr_gpio = <0xffffffff 0x29 0x00>;
		};
	};

	fragment@17 {
		target = <0xffffffff>;

		__overlay__ {
			bc12_sel = <0x01>;
		};
	};

	fragment@18 {
		target = <0xffffffff>;

		__overlay__ {
			temp_t4_threshold = <0x3c>;
		};
	};

	fragment@19 {
		target = <0xffffffff>;

		__overlay__ {

			fps_irq {
				phandle = <0x14>;

				pins_cmd_dat {
					pinmux = <0xe00>;
					slew-rate = <0x00>;
					bias-disable;
				};
			};

			fps_reset_high {
				phandle = <0x15>;

				pins_cmd_dat {
					pinmux = <0xaa00>;
					slew-rate = <0x01>;
					output-high;
				};
			};

			fps_reset_low {
				phandle = <0x16>;

				pins_cmd_dat {
					pinmux = <0xaa00>;
					slew-rate = <0x01>;
					output-low;
				};
			};
		};
	};

	fragment@20 {
		target = <0xffffffff>;

		__overlay__ {

			fingerprint_int {
				compatible = "mediatek,fingerprint-fpc";
				fpc,enable-wakeup;
				interrupt-parent = <0xffffffff>;
				interrupts = <0x0e 0x01 0x0e 0x00>;
				pinctrl-names = "fingerprint_irq\0fingerprint_reset_high\0fingerprint_reset_low";
				pinctrl-0 = <0x14>;
				pinctrl-1 = <0x15>;
				pinctrl-2 = <0x16>;
				fpc,rst = <0xffffffff 0xaa 0x00>;
				fpc,irq = <0xffffffff 0x0e 0x00>;
				status = "okay";
				phandle = <0x56>;
			};

			goodix_int {
				compatible = "mediatek,fingerprint-goodix";
				interrupt-parent = <0xffffffff>;
				interrupts = <0x0e 0x01 0x0e 0x00>;
				pinctrl-names = "fingerprint_irq\0fingerprint_reset_high\0fingerprint_reset_low";
				pinctrl-0 = <0x14>;
				pinctrl-1 = <0x15>;
				pinctrl-2 = <0x16>;
				int-gpios = <0xffffffff 0x0e 0x00>;
				status = "okay";
				phandle = <0x57>;
			};
		};
	};

	fragment@21 {
		target = <0xffffffff>;

		__overlay__ {
			#address-cells = <0x01>;
			#size-cells = <0x00>;
			mediatek,pad-select = <0x00 0x01>;
			tee-only;

			fpc_tee@0 {
				compatible = "fpc,fpc_spi";
				reg = <0x00>;
				fpc,enable-wakeup;
				spi-max-frequency = <0x7a1200>;
				netlink-event = <0x1f>;
				status = "okay";
			};

			goodix_tee@1 {
				status = "okay";
				compatible = "goodix,goodix-fp";
				reg = <0x01>;
				spi-max-frequency = <0x7a1200>;
				netlink-event = <0x1e>;
			};
		};
	};

	fragment@22 {
		target = <0xffffffff>;

		__overlay__ {
			tpd-resolution = <0x2d0 0x640>;
			use-tpd-button = <0x00>;
			tpd-key-num = <0x03>;
			tpd-key-local = <0x8b 0xac 0x9e 0x00>;
			tpd-key-dim-local = <0x5a 0x373 0x64 0x28 0xe6 0x373 0x64 0x28 0x172 0x373 0x64 0x28 0x00 0x00 0x00 0x00>;
			tpd-max-touch-num = <0x0a>;
			tpd-filter-enable = <0x01>;
			tpd-filter-pixel-density = <0x92>;
			tpd-filter-custom-prameters = <0x00 0x00 0x00 0x00 0x00 0x00 0x00 0x00 0x00 0x00 0x00 0x00>;
			tpd-filter-custom-speed = <0x00 0x00 0x00>;
			tpd-panel-match;
			pinctrl-names = "default\0state_eint_as_int\0state_eint_output0\0state_eint_output1\0state_rst_output0\0state_rst_output1";
			pinctrl-0 = <0x17>;
			pinctrl-1 = <0x18>;
			pinctrl-2 = <0x19>;
			pinctrl-3 = <0x1a>;
			pinctrl-4 = <0x1b>;
			pinctrl-5 = <0x1c>;
			status = "okay";
		};
	};

	fragment@23 {
		target = <0xffffffff>;

		__overlay__ {

			eint0default {
				phandle = <0x17>;
			};

			eint@0 {
				phandle = <0x18>;

				pins_cmd_dat {
					pinmux = <0xa00>;
					slew-rate = <0x00>;
					bias-disable;
				};
			};

			eintoutput0 {
				phandle = <0x19>;

				pins_cmd_dat {
					pinmux = <0xa00>;
					slew-rate = <0x01>;
					output-low;
				};
			};

			eintoutput1 {
				phandle = <0x1a>;

				pins_cmd_dat {
					pinmux = <0xa00>;
					slew-rate = <0x01>;
					output-high;
				};
			};

			rstoutput0 {
				phandle = <0x1b>;

				pins_cmd_dat {
					pinmux = <0xa400>;
					slew-rate = <0x01>;
					output-low;
				};
			};

			rstoutput1 {
				phandle = <0x1c>;

				pins_cmd_dat {
					pinmux = <0xa400>;
					slew-rate = <0x01>;
					output-high;
				};
			};
		};
	};

	fragment@24 {
		target = <0xffffffff>;

		__overlay__ {
			#address-cells = <0x01>;
			#size-cells = <0x00>;

			touch@0 {
				compatible = "tchip,ilitek\0novatek,NVT-ts-spi\0chipone-tddi";
				spi-max-frequency = <0x989680>;
				reg = <0x00>;
				status = "okay";
				novatek,reset-gpio = <0xffffffff 0xa4 0x00>;
				novatek,irq-gpio = <0xffffffff 0x0a 0x7d8>;
				touch,reset-gpio = <0xffffffff 0xa4 0x00>;
				touch,irq-gpio = <0xffffffff 0x0a 0x2008>;
				chipone,rst-gpio = <0xffffffff 0xa4 0x00>;
				chipone,irq-gpio = <0xffffffff 0x0a 0x7d8>;
				chipone,x-res = <0x2d0>;
				chipone,y-res = <0x640>;
				novatek,swrst-n8-addr = <0x3f0fe>;
				novatek,spi-rd-fast-addr = <0x3f310>;
			};
		};
	};

	fragment@25 {
		target = <0xffffffff>;

		__overlay__ {

			camera_pins_cam0_mclk_on {
				phandle = <0x36>;

				pins_cmd_dat {
					pinmux = <0x6301>;
				};
			};

			camera_pins_cam0_mclk_off {
				phandle = <0x37>;

				pins_cmd_dat {
					pinmux = <0x6300>;
				};
			};

			camera_pins_cam1_mclk_on {
				phandle = <0x38>;

				pins_cmd_dat {
					pinmux = <0x6401>;
				};
			};

			camera_pins_cam1_mclk_off {
				phandle = <0x39>;

				pins_cmd_dat {
					pinmux = <0x6400>;
				};
			};

			camera_pins_cam2_mclk_on {
				phandle = <0x3a>;

				pins_cmd_dat {
					pinmux = <0x6c01>;
				};
			};

			camera_pins_cam2_mclk_off {
				phandle = <0x3b>;

				pins_cmd_dat {
					pinmux = <0x6c00>;
				};
			};

			camera_pins_cam4_mclk_on {
				phandle = <0x3c>;

				pins_cmd_dat {
					pinmux = <0x5801>;
				};
			};

			camera_pins_cam4_mclk_off {
				phandle = <0x3d>;

				pins_cmd_dat {
					pinmux = <0x5800>;
				};
			};

			cam0@0 {
				phandle = <0x1e>;

				pins_cmd_dat {
					pinmux = <0x6500>;
					slew-rate = <0x01>;
					output-low;
				};
			};

			cam0@1 {
				phandle = <0x1f>;

				pins_cmd_dat {
					pinmux = <0x6500>;
					slew-rate = <0x01>;
					output-high;
				};
			};

			cam0@2 {
				phandle = <0x20>;

				pins_cmd_dat {
					pinmux = <0x6100>;
					slew-rate = <0x01>;
					output-low;
				};
			};

			cam0@3 {
				phandle = <0x21>;

				pins_cmd_dat {
					pinmux = <0x6100>;
					slew-rate = <0x01>;
					output-high;
				};
			};

			cam1@0 {
				phandle = <0x22>;

				pins_cmd_dat {
					pinmux = <0x6600>;
					slew-rate = <0x01>;
					output-low;
				};
			};

			cam1@1 {
				phandle = <0x23>;

				pins_cmd_dat {
					pinmux = <0x6600>;
					slew-rate = <0x01>;
					output-high;
				};
			};

			cam1@2 {
				phandle = <0x24>;

				pins_cmd_dat {
					pinmux = <0x6100>;
					slew-rate = <0x01>;
					output-low;
				};
			};

			cam1@3 {
				phandle = <0x25>;

				pins_cmd_dat {
					pinmux = <0x6100>;
					slew-rate = <0x01>;
					output-high;
				};
			};

			cam2@0 {
				phandle = <0x26>;

				pins_cmd_dat {
					pinmux = <0x6d00>;
					slew-rate = <0x01>;
					output-low;
				};
			};

			cam2@1 {
				phandle = <0x27>;

				pins_cmd_dat {
					pinmux = <0x6d00>;
					slew-rate = <0x01>;
					output-high;
				};
			};

			cam2@2 {
				phandle = <0x28>;

				pins_cmd_dat {
					pinmux = <0xa000>;
					slew-rate = <0x01>;
					output-low;
				};
			};

			cam2@3 {
				phandle = <0x29>;

				pins_cmd_dat {
					pinmux = <0xa000>;
					slew-rate = <0x01>;
					output-high;
				};
			};

			cam4@0 {
				phandle = <0x2a>;

				pins_cmd_dat {
					pinmux = <0x5700>;
					slew-rate = <0x01>;
					output-low;
				};
			};

			cam4@1 {
				phandle = <0x2b>;

				pins_cmd_dat {
					pinmux = <0x5700>;
					slew-rate = <0x01>;
					output-high;
				};
			};

			cam0@vcama0 {
				phandle = <0x2d>;

				pins_cmd_dat {
					pinmux = <0x5c00>;
					slew-rate = <0x01>;
					output-low;
				};
			};

			cam0@vcama1 {
				phandle = <0x2c>;

				pins_cmd_dat {
					pinmux = <0x5c00>;
					slew-rate = <0x01>;
					output-high;
				};
			};

			cam0@vcamd0 {
				phandle = <0x2f>;

				pins_cmd_dat {
					pinmux = <0xb100>;
					slew-rate = <0x01>;
					output-low;
				};
			};

			cam0@vcamd1 {
				phandle = <0x2e>;

				pins_cmd_dat {
					pinmux = <0xb100>;
					slew-rate = <0x01>;
					output-high;
				};
			};

			cam1@vcama0 {
				phandle = <0x31>;

				pins_cmd_dat {
					pinmux = <0x6200>;
					slew-rate = <0x01>;
					output-low;
				};
			};

			cam1@vcama1 {
				phandle = <0x30>;

				pins_cmd_dat {
					pinmux = <0x6200>;
					slew-rate = <0x01>;
					output-high;
				};
			};

			cam2@vcama0 {
				phandle = <0x33>;

				pins_cmd_dat {
					pinmux = <0x9f00>;
					slew-rate = <0x01>;
					output-low;
				};
			};

			cam2@vcama1 {
				phandle = <0x32>;

				pins_cmd_dat {
					pinmux = <0x9f00>;
					slew-rate = <0x01>;
					output-high;
				};
			};

			cam4@vcama0 {
				phandle = <0x35>;

				pins_cmd_dat {
					pinmux = <0x5c00>;
					slew-rate = <0x01>;
					output-low;
				};
			};

			cam4@vcama1 {
				phandle = <0x34>;

				pins_cmd_dat {
					pinmux = <0x5c00>;
					slew-rate = <0x01>;
					output-high;
				};
			};

			camdefault {
				phandle = <0x1d>;
			};
		};
	};

	fragment@26 {
		target = <0xffffffff>;

		__overlay__ {
			pinctrl-names = "default\0cam0_rst0\0cam0_rst1\0cam0_pnd0\0cam0_pnd1\0cam1_rst0\0cam1_rst1\0cam1_pnd0\0cam1_pnd1\0cam2_rst0\0cam2_rst1\0cam2_pnd0\0cam2_pnd1\0cam4_rst0\0cam4_rst1\0cam0_vcama_on\0cam0_vcama_off\0cam0_vcamd_on\0cam0_vcamd_off\0cam1_vcama_on\0cam1_vcama_off\0cam2_vcama_on\0cam2_vcama_off\0cam4_vcama_on\0cam4_vcama_off\0cam0_mclk_on\0cam0_mclk_off\0cam1_mclk_on\0cam1_mclk_off\0cam2_mclk_on\0cam2_mclk_off\0cam4_mclk_on\0cam4_mclk_off";
			pinctrl-0 = <0x1d>;
			pinctrl-1 = <0x1e>;
			pinctrl-2 = <0x1f>;
			pinctrl-3 = <0x20>;
			pinctrl-4 = <0x21>;
			pinctrl-5 = <0x22>;
			pinctrl-6 = <0x23>;
			pinctrl-7 = <0x24>;
			pinctrl-8 = <0x25>;
			pinctrl-9 = <0x26>;
			pinctrl-10 = <0x27>;
			pinctrl-11 = <0x28>;
			pinctrl-12 = <0x29>;
			pinctrl-13 = <0x2a>;
			pinctrl-14 = <0x2b>;
			pinctrl-15 = <0x2c>;
			pinctrl-16 = <0x2d>;
			pinctrl-17 = <0x2e>;
			pinctrl-18 = <0x2f>;
			pinctrl-19 = <0x30>;
			pinctrl-20 = <0x31>;
			pinctrl-21 = <0x32>;
			pinctrl-22 = <0x33>;
			pinctrl-23 = <0x34>;
			pinctrl-24 = <0x35>;
			pinctrl-25 = <0x36>;
			pinctrl-26 = <0x37>;
			pinctrl-27 = <0x38>;
			pinctrl-28 = <0x39>;
			pinctrl-29 = <0x3a>;
			pinctrl-30 = <0x3b>;
			pinctrl-31 = <0x3c>;
			pinctrl-32 = <0x3d>;
			cam0_vcamio-supply = <0xffffffff>;
			cam1_vcamd-supply = <0xffffffff>;
			cam1_vcamio-supply = <0xffffffff>;
			cam2_vcama-supply = <0xffffffff>;
			cam2_vcamio-supply = <0xffffffff>;
			cam4_vcamio-supply = <0xffffffff>;
			cam0_enable_sensor = "mot_tonga_s5kjn1sq_mipi_raw";
			cam1_enable_sensor = "mot_tonga_s5k4h7_mipi_raw";
			cam2_enable_sensor = "mot_tonga_ov02b1b_mipi_raw mot_tonga_gc02m1b_mipi_raw";
			cam3_enable_sensor = "mot_tonga_null_mipi";
			cam4_enable_sensor = "mot_tonga_gc02m1_mipi_raw";
			status = "okay";
		};
	};

	fragment@27 {
		target = <0xffffffff>;

		__overlay__ {

			flash_default_cfg {
				phandle = <0x3e>;
			};

			flash_en_pin0 {
				phandle = <0x3f>;

				pins_cmd_dat {
					pinmux = <0xad00>;
					slew-rate = <0x01>;
					output-low;
				};
			};

			flash_en_pin1 {
				phandle = <0x40>;

				pins_cmd_dat {
					pinmux = <0xad00>;
					slew-rate = <0x01>;
					output-high;
				};
			};

			torch_en_pin0 {
				phandle = <0x41>;

				pins_cmd_dat {
					pinmux = <0x9a00>;
					slew-rate = <0x01>;
					output-low;
				};
			};

			torch_en_pin1 {
				phandle = <0x42>;

				pins_cmd_dat {
					pinmux = <0x9a00>;
					slew-rate = <0x01>;
					output-high;
				};
			};
		};
	};

	fragment@28 {
		target = <0xffffffff>;

		__overlay__ {
			pinctrl-names = "flash_default\0flash_en_pin0\0flash_en_pin1\0torch_en_pin0\0torch_en_pin1";
			pinctrl-0 = <0x3e>;
			pinctrl-1 = <0x3f>;
			pinctrl-2 = <0x40>;
			pinctrl-3 = <0x41>;
			pinctrl-4 = <0x42>;
			status = "okay";
		};
	};

	fragment@29 {
		target = <0xffffffff>;

		__overlay__ {
			camaf_m1_pmic-supply = <0xffffffff>;
			status = "okay";
		};
	};

	fragment@30 {
		target = <0xffffffff>;

		__overlay__ {
			bc12_active = <0x00>;
		};
	};

	fragment@31 {
		target = <0xffffffff>;

		__overlay__ {
			bc12_sel = <0x00>;
		};
	};

	fragment@32 {
		target = <0xffffffff>;

		__overlay__ {
			charger = <0xffffffff>;
		};
	};

	fragment@33 {
		target = <0xffffffff>;

		__overlay__ {
			compatible = "mediatek,mtboard-thermistor1";
			io-channels = <0xffffffff 0x00>;
			io-channel-names = "thermistor-ch0";
			interconnects = <0xffffffff 0x00>;
		};
	};

	fragment@34 {
		target = <0xffffffff>;

		__overlay__ {
			compatible = "mediatek,mtboard-thermistor2";
			io-channels = <0xffffffff 0x01>;
			io-channel-names = "thermistor-ch1";
			interconnects = <0xffffffff 0x01>;
		};
	};

	fragment@35 {
		target = <0xffffffff>;

		__overlay__ {
			compatible = "mediatek,mtboard-thermistor3";
			io-channels = <0xffffffff 0x02>;
			io-channel-names = "thermistor-ch2";
			interconnects = <0xffffffff 0x02>;
		};
	};

	fragment@36 {
		target = <0xffffffff>;

		__overlay__ {
			compatible = "mediatek,mtboard-thermistor4";
			io-channels = <0xffffffff 0x03>;
			io-channel-names = "thermistor-ch3";
			interconnects = <0xffffffff 0x03>;
		};
	};

	fragment@37 {
		target = <0xffffffff>;

		__overlay__ {

			bq25601@6B {
				compatible = "ti,bq25601";
				reg = <0x6b>;
				ti,bq2560x,usb-vlim = <0x11f8>;
				ti,bq2560x,usb-ilim = <0x7d0>;
				ti,bq2560x,usb-vreg = <0x1130>;
				ti,bq2560x,usb-ichg = <0x7d0>;
				ti,bq2560x,precharge-current = <0x100>;
				ti,bq2560x,termination-current = <0x78>;
				ti,bq2560x,boost-voltage = <0x1386>;
				ti,bq2560x,boost-current = <0x4b0>;
				ti,bq2560x,enable_term;
				ti,bq2560x,stat-pin-ctrl = <0x03>;
				ti,bq2560x,vac-ovp-threshold = <0x1964>;
				phandle = <0x43>;
			};

			bq25601@1A {
				compatible = "ti,bq25601";
				reg = <0x1a>;
				ti,bq2560x,usb-vlim = <0x11f8>;
				ti,bq2560x,usb-ilim = <0x7d0>;
				ti,bq2560x,usb-vreg = <0x1130>;
				ti,bq2560x,usb-ichg = <0x7d0>;
				ti,bq2560x,precharge-current = <0x100>;
				ti,bq2560x,termination-current = <0x78>;
				ti,bq2560x,boost-voltage = <0x1386>;
				ti,bq2560x,boost-current = <0x4b0>;
				ti,bq2560x,enable_term;
				ti,bq2560x,stat-pin-ctrl = <0x03>;
				ti,bq2560x,vac-ovp-threshold = <0x1964>;
				phandle = <0x44>;
			};
		};
	};

	fragment@38 {
		target = <0xffffffff>;

		__overlay__ {
			pd_vbus_upper_bound = <0x4c4b40>;
		};
	};

	fragment@39 {
		target = <0xffffffff>;

		__overlay__ {
			ac_charger_input_current = <0x1e8480>;
			non_std_ac_charger_current = <0x7a120>;
			charging_host_charger_current = <0x1e8480>;
			ta_ac_charger_current = <0x1e8480>;
		};
	};

	fragment@40 {
		target = <0xffffffff>;

		__overlay__ {
			status = "disable";
		};
	};

	fragment@41 {
		target = <0xffffffff>;

		__overlay__ {
			status = "disable";
		};
	};

	fragment@42 {
		target = <0xffffffff>;

		__overlay__ {
			status = "disable";
		};
	};

	fragment@43 {
		target = <0xffffffff>;

		__overlay__ {
			charger = <0xffffffff>;
			battery_cv = <0x432380>;
			max_charger_voltage = <0x632ea0>;
			min_charger_voltage = <0x4630c0>;
			usb_charger_current_suspend = <0x00>;
			usb_charger_current_unconfigured = <0x11170>;
			usb_charger_current_configured = <0x7a120>;
			usb_charger_current = <0x7a120>;
			ac_charger_current = <0x1e8480>;
			ac_charger_input_current = <0x1e8480>;
			non_std_ac_charger_current = <0xf4240>;
			charging_host_charger_current = <0x16e360>;
			apple_1_0a_charger_current = <0x9eb10>;
			apple_2_1a_charger_current = "\0\f5";
			ta_ac_charger_current = <0x1e8480>;
			typec_limit_aicr = <0x2dc6c0>;
			mmi,iterm-ma = <0x96>;
			mmi,mmi-temp-zones = <0x00 0x1068 0x3e8 0x00 0x0f 0x00 0x3e8 0x3e8 0x2d 0x00 0xbb8 0xbb8 0x3c 0x1068 0x9c4 0x00>;
			mmi,enable-charging-limit;
			mmi,upper-limit-capacity = <0x41>;
			mmi,lower-limit-capacity = <0x3c>;
		};
	};

	fragment@44 {
		target = <0xffffffff>;

		__overlay__ {
			charger = <0xffffffff>;
			extern_charger = <0x43>;
			extern_charger_sgm41513 = <0x44>;
			DIFFERENCE_FULLOCV_ITH = <0x50>;
			EMBEDDED_SEL = <0x01>;
			VIR_OLDOCV_DIFF_EMB = <0xbb8>;
			VIR_OLDOCV_DIFF_EMB_LT = <0xbb8>;
			g_temperature = <0x32 0x19 0x0a 0x00 0xfffffff6 0xffffffe7 0xffffffe2 0xffffffdd 0xffffffd8 0xffffffd3>;
			g_FG_PSEUDO100 = <0x62 0x62 0x64 0x64 0x62 0x62 0x64 0x64 0x62 0x62 0x64 0x64 0x62 0x62 0x64 0x64 0x62 0x62 0x64 0x64 0x64 0x64 0x64 0x64 0x64 0x64 0x64 0x64 0x64 0x64 0x64 0x64 0x64 0x64 0x64 0x64 0x64 0x64 0x64 0x64>;
			g_Q_MAX = <0x12d6 0x1307 0x9ba 0x7ad 0x12f8 0x1348 0x9a4 0x7c0 0x12f6 0x1329 0x906 0x79a 0x1275 0x12ba 0x742 0x751 0x12f8 0x1338 0x733 0x73b 0x8a3 0x674 0x5fd 0x605 0x899 0x66a 0x5f3 0x5fb 0x88f 0x660 0x5e9 0x5f1 0x885 0x656 0x5df 0x5e7 0x87b 0x64c 0x5d5 0x5dd>;
			g_Q_MAX_H_CURRENT = <0x12d6 0x1307 0x88e 0x681 0x12f8 0x1348 0x878 0x694 0x12f6 0x1329 0x7da 0x66e 0x1275 0x12ba 0x616 0x625 0x12f8 0x1338 0x607 0x60f 0x8a2 0x672 0x5fd 0x605 0x898 0x668 0x5f3 0x5fb 0x88e 0x65e 0x5e9 0x5f1 0x884 0x654 0x5df 0x5e7 0x87a 0x64a 0x5d5 0x5dd>;
			ACTIVE_TABLE = <0x05>;
			df-serialnum = "SB18C98449";
			serialnum_1 = "SB18C98449";
			battery1_name = "SWD_4V4_5000MAH";
			battery1_profile_t0_num = <0x64>;
			battery1_profile_t0_col = <0x03>;
			battery1_profile_t0 = <0x00 0xa9ce 0x3e8 0x1f7 0xa93f 0x3e8 0x3ef 0xa8be 0x3fc 0x5e6 0xa840 0x406 0x7de 0xa7c3 0x406 0x9d5 0xa745 0x406 0xbcd 0xa6c7 0x406 0xdc4 0xa652 0x406 0xfbb 0xa5dc 0x414 0x11b3 0xa561 0x40f 0x13aa 0xa4e7 0x406 0x15a2 0xa472 0x406 0x1799 0xa3fd 0x407 0x1991 0xa390 0x418 0x1b88 0xa31d 0x41a 0x1d80 0xa2a8 0x41a 0x1f77 0xa237 0x41a 0x216e 0xa1c7 0x41a 0x2366 0xa153 0x41a 0x255d 0xa0e6 0x41a 0x2755 0xa079 0x41a 0x294c 0xa00c 0x41a 0x2b44 0x9fa3 0x427 0x2d3b 0x9f3e 0x438 0x2f32 0x9ed8 0x438 0x312a 0x9e6b 0x438 0x3321 0x9e0e 0x438 0x3519 0x9dab 0x438 0x3710 0x9d47 0x438 0x3908 0x9ce5 0x43e 0x3aff 0x9c89 0x44c 0x3cf6 0x9c2d 0x44c 0x3eee 0x9bd9 0x44c 0x40e5 0x9b85 0x460 0x42dd 0x9b31 0x46a 0x44d4 0x9add 0x471 0x46cc 0x9a8b 0x484 0x48c3 0x9a3f 0x49d 0x4abb 0x99f4 0x4c7 0x4cb2 0x99a1 0x4dc 0x4ea9 0x993d 0x4e2 0x50a1 0x98be 0x4a9 0x5298 0x982f 0x442 0x5490 0x97b3 0x41a 0x5687 0x9757 0x41a 0x587f 0x9710 0x41a 0x5a76 0x96cd 0x40f 0x5c6d 0x968e 0x406 0x5e65 0x9656 0x406 0x605c 0x9623 0x406 0x6254 0x95f1 0x406 0x644b 0x95be 0x415 0x6643 0x958c 0x40e 0x683a 0x955e 0x40f 0x6a31 0x9531 0x414 0x6c29 0x9501 0x408 0x6e20 0x94e0 0x419 0x7018 0x94b6 0x40a 0x720f 0x9493 0x413 0x7407 0x9471 0x41a 0x75fe 0x9450 0x41a 0x77f5 0x942e 0x41a 0x79ed 0x940c 0x41a 0x7be4 0x93f3 0x433 0x7ddc 0x93da 0x445 0x7fd3 0x93c1 0x44c 0x81cb 0x93a8 0x456 0x83c2 0x938d 0x46a 0x85ba 0x936a 0x469 0x87b1 0x9328 0x440 0x89a8 0x92d8 0x401 0x8ba0 0x9299 0x3f8 0x8d97 0x926a 0x406 0x8f8f 0x9240 0x40a 0x9186 0x9216 0x419 0x937e 0x91ec 0x408 0x9575 0x91c9 0x414 0x976c 0x91a8 0x41a 0x9964 0x9186 0x426 0x9b5b 0x9162 0x43d 0x9d53 0x9137 0x44b 0x9f4a 0x90fc 0x43a 0xa142 0x90c1 0x421 0xa339 0x9087 0x42c 0xa530 0x9048 0x438 0xa728 0x9002 0x422 0xa91f 0x8fbd 0x3eb 0xab17 0x8fa4 0x404 0xad0e 0x8f9a 0x42d 0xaf06 0x8f92 0x464 0xb0fd 0x8f85 0x48c 0xb2f5 0x8f6b 0x4a5 0xb4ec 0x8f26 0x4b6 0xb6e3 0x8e5c 0x49d 0xb8db 0x8cb5 0x49c 0xbad2 0x8a92 0x4bd 0xbcca 0x87b3 0x4e7 0xbec1 0x833f 0x577 0xc0b9 0x7e22 0x672 0xc2b0 0x7e22 0x672>;
			battery1_profile_t1_num = <0x64>;
			battery1_profile_t1_col = <0x03>;
			battery1_profile_t1 = <0x00 0xaa1e 0x4b0 0x1f7 0xa98f 0x4b0 0x3ef 0xa90e 0x4c4 0x5e6 0xa890 0x4d8 0x7de 0xa80f 0x4d0 0x9d5 0xa78d 0x4b6 0xbcd 0xa717 0x4ce 0xdc4 0xa699 0x4ce 0xfbb 0xa629 0x4dc 0x11b3 0xa5b1 0x4d7 0x13aa 0xa537 0x4ce 0x15a2 0xa4c2 0x4ce 0x1799 0xa44c 0x4ce 0x1991 0xa3d7 0x4ce 0x1b88 0xa36b 0x4dd 0x1d80 0xa2f8 0x4e2 0x1f77 0xa287 0x4e2 0x216e 0xa21a 0x4e9 0x2366 0xa1ad 0x502 0x255d 0xa140 0x513 0x2755 0xa0cb 0x505 0x294c 0xa05c 0x500 0x2b44 0x9ff3 0x509 0x2d3b 0x9f91 0x51c 0x2f32 0x9f3a 0x538 0x312a 0x9eff 0x562 0x3321 0x9eac 0x574 0x3519 0x9e2c 0x558 0x3710 0x9d8f 0x546 0x3908 0x9cf0 0x546 0x3aff 0x9c69 0x54b 0x3cf6 0x9c05 0x564 0x3eee 0x9bb9 0x564 0x40e5 0x9b82 0x586 0x42dd 0x9b4f 0x5b0 0x44d4 0x9b12 0x5bd 0x46cc 0x9ac7 0x5b3 0x48c3 0x9a7b 0x5dc 0x4abb 0x9a27 0x5dc 0x4cb2 0x99d3 0x5dc 0x4ea9 0x997a 0x5dc 0x50a1 0x9913 0x5c9 0x5298 0x989b 0x591 0x5490 0x9816 0x52e 0x5687 0x97a9 0x4eb 0x587f 0x974a 0x4be 0x5a76 0x96ff 0x4b0 0x5c6d 0x96bc 0x4a8 0x5e65 0x967e 0x4a1 0x605c 0x964a 0x4ae 0x6254 0x9610 0x49e 0x644b 0x95e4 0x4ab 0x6643 0x95b4 0x4b0 0x683a 0x9586 0x4b0 0x6a31 0x955c 0x4b0 0x6c29 0x9532 0x4b3 0x6e20 0x9508 0x4cd 0x7018 0x94de 0x4b6 0x720f 0x94bb 0x4b0 0x7407 0x9499 0x4be 0x75fe 0x947b 0x4d4 0x77f5 0x9460 0x4e2 0x79ed 0x943e 0x4e2 0x7be4 0x9425 0x4e2 0x7ddc 0x9405 0x4e2 0x7fd3 0x93ee 0x4f1 0x81cb 0x93da 0x507 0x83c2 0x93c0 0x514 0x85ba 0x93a7 0x514 0x87b1 0x938f 0x503 0x89a8 0x936f 0x4eb 0x8ba0 0x934d 0x4d8 0x8d97 0x932c 0x4ce 0x8f8f 0x930a 0x4c8 0x9186 0x92e8 0x4b0 0x937e 0x92be 0x4b0 0x9575 0x929b 0x4b0 0x976c 0x9274 0x4b0 0x9964 0x924e 0x4b0 0x9b5b 0x922d 0x4b7 0x9d53 0x920a 0x4ce 0x9f4a 0x91e0 0x4ce 0xa142 0x91a7 0x4ce 0xa339 0x916d 0x4da 0xa530 0x9132 0x4e2 0xa728 0x90f4 0x4e2 0xa91f 0x90af 0x4e0 0xab17 0x905b 0x4cf 0xad0e 0x903e 0x4f5 0xaf06 0x902b 0x500 0xb0fd 0x901b 0x509 0xb2f5 0x900a 0x52c 0xb4ec 0x8ff6 0x572 0xb6e3 0x8fd5 0x5c6 0xb8db 0x8f30 0x5c8 0xbad2 0x8dbb 0x5b4 0xbcca 0x8bb6 0x5ea 0xbec1 0x8906 0x663 0xc0b9 0x8514 0x757 0xc2b0 0x7eb8 0x9f6>;
			battery1_profile_t2_num = <0x64>;
			battery1_profile_t2_col = <0x03>;
			battery1_profile_t2 = <0x00 0xaa0a 0x820 0x1f7 0xa98c 0x820 0x3ef 0xa901 0x864 0x5e6 0xa87c 0x884 0x7de 0xa7ff 0x884 0x9d5 0xa781 0x884 0xbcd 0xa703 0x883 0xdc4 0xa68e 0x86a 0xfbb 0xa618 0x866 0x11b3 0xa5a3 0x866 0x13aa 0xa52d 0x866 0x15a2 0xa4b8 0x861 0x1799 0xa443 0x852 0x1991 0xa3d6 0x852 0x1b88 0xa36b 0x861 0x1d80 0xa2fe 0x866 0x1f77 0xa28d 0x85e 0x216e 0xa21a 0x852 0x2366 0xa1ad 0x854 0x255d 0xa140 0x865 0x2755 0xa0d3 0x87d 0x294c 0xa066 0x872 0x2b44 0x9ffd 0x866 0x2d3b 0x9fa3 0x87d 0x2f32 0x9f62 0x8c2 0x312a 0x9f27 0x916 0x3321 0x9ec4 0x92a 0x3519 0x9e2c 0x901 0x3710 0x9d7b 0x8d0 0x3908 0x9ccf 0x8ad 0x3aff 0x9c3e 0x895 0x3cf6 0x9bc9 0x884 0x3eee 0x9b75 0x895 0x40e5 0x9b35 0x8ba 0x42dd 0x9aff 0x8e4 0x44d4 0x9ac9 0x907 0x46cc 0x9a8d 0x91e 0x48c3 0x9a49 0x92d 0x4abb 0x99f5 0x91d 0x4cb2 0x9993 0x8f7 0x4ea9 0x9924 0x8b1 0x50a1 0x98af 0x866 0x5298 0x983d 0x81f 0x5490 0x97d1 0x7cf 0x5687 0x9775 0x7be 0x587f 0x9727 0x7bc 0x5a76 0x96e1 0x7ab 0x5c6d 0x96a2 0x7aa 0x5e65 0x9667 0x7b5 0x605c 0x962d 0x7a0 0x6254 0x95fb 0x7ba 0x644b 0x95c8 0x7bc 0x6643 0x959c 0x7c8 0x683a 0x956e 0x7d0 0x6a31 0x953e 0x7d0 0x6c29 0x9515 0x7d3 0x6e20 0x94f4 0x7ed 0x7018 0x94ca 0x7ee 0x720f 0x94a7 0x7fb 0x7407 0x9485 0x802 0x75fe 0x9467 0x812 0x77f5 0x944c 0x831 0x79ed 0x942a 0x820 0x7be4 0x9411 0x831 0x7ddc 0x93f8 0x848 0x7fd3 0x93df 0x852 0x81cb 0x93c6 0x848 0x83c2 0x93b0 0x83d 0x85ba 0x93a8 0x866 0x87b1 0x9397 0x866 0x89a8 0x9386 0x866 0x8ba0 0x9376 0x876 0x8d97 0x9361 0x88b 0x8f8f 0x9346 0x898 0x9186 0x9324 0x899 0x937e 0x9303 0x8b2 0x9575 0x92da 0x8b6 0x976c 0x92b0 0x8c1 0x9964 0x928a 0x8de 0x9b5b 0x9266 0x908 0x9d53 0x923b 0x932 0x9f4a 0x9200 0x95c 0xa142 0x91be 0x977 0xa339 0x9186 0x9a7 0xa530 0x914c 0x9e6 0xa728 0x9103 0xa27 0xa91f 0x90b1 0xa63 0xab17 0x906e 0xaa6 0xad0e 0x9052 0xb08 0xaf06 0x9039 0xb80 0xb0fd 0x9020 0xc15 0xb2f5 0x9004 0xcd5 0xb4ec 0x8fda 0xdcd 0xb6e3 0x8f86 0xf03 0xb8db 0x8e7d 0x1029 0xbad2 0x8cab 0x1170 0xbcca 0x8a31 0x13b2 0xbec1 0x86c0 0x1779 0xc0b9 0x8318 0x1ba8 0xc2b0 0x8318 0x1ba8>;
			battery1_profile_t3_num = <0x64>;
			battery1_profile_t3_col = <0x03>;
			battery1_profile_t3 = <0x00 0xa94c 0xce4 0x1f7 0xa893 0xce4 0x3ef 0xa7f6 0xd06 0x5e6 0xa769 0xd26 0x7de 0xa6e7 0xd3b 0x9d5 0xa66b 0xd4e 0xbcd 0xa5f5 0xd65 0xdc4 0xa577 0xd4c 0xfbb 0xa4f9 0xd48 0x11b3 0xa486 0xd59 0x13aa 0xa415 0xd5a 0x15a2 0xa3a2 0xd48 0x1799 0xa335 0xd4a 0x1991 0xa2c8 0xd63 0x1b88 0xa255 0xd75 0x1d80 0xa1e6 0xd7a 0x1f77 0xa179 0xd86 0x216e 0xa10c 0xd98 0x2366 0xa0a0 0xd98 0x255d 0xa03b 0xd98 0x2755 0x9fe6 0xdbe 0x294c 0x9fa4 0xe31 0x2b44 0x9f5c 0xe97 0x2d3b 0x9efa 0xec4 0x2f32 0x9e73 0xeb4 0x312a 0x9dbb 0xe47 0x3321 0x9d02 0xe0a 0x3519 0x9c63 0xddc 0x3710 0x9bdf 0xdbc 0x3908 0x9b76 0xdbc 0x3aff 0x9b26 0xde6 0x3cf6 0x9ae2 0xe10 0x3eee 0x9aa8 0xe3a 0x40e5 0x9a6d 0xe56 0x42dd 0x9a28 0xe60 0x44d4 0x99d9 0xe55 0x46cc 0x9981 0xe39 0x48c3 0x991d 0xe0e 0x4abb 0x98b8 0xdd3 0x4cb2 0x984c 0xd91 0x4ea9 0x97e5 0xd5f 0x50a1 0x9781 0xd2e 0x5298 0x9725 0xd06 0x5490 0x96e2 0xd15 0x5687 0x9696 0xd04 0x587f 0x9659 0xd10 0x5a76 0x9624 0xd32 0x5c6d 0x95ee 0xd48 0x5e65 0x95b6 0xd4f 0x605c 0x9584 0xd68 0x6254 0x955a 0xd78 0x644b 0x9530 0xd91 0x6643 0x9506 0xda4 0x683a 0x94e1 0xdc2 0x6a31 0x94bc 0xde6 0x6c29 0x9493 0xdfe 0x6e20 0x9472 0xe0f 0x7018 0x9458 0xe38 0x720f 0x9439 0xe55 0x7407 0x941c 0xe69 0x75fe 0x9406 0xe84 0x77f5 0x93f5 0xead 0x79ed 0x93e4 0xed7 0x7be4 0x93dc 0xf1a 0x7ddc 0x93cd 0xf49 0x7fd3 0x93bc 0xf7d 0x81cb 0x93af 0xfc2 0x83c2 0x93a4 0x1013 0x85ba 0x9394 0x1056 0x87b1 0x9383 0x10a9 0x89a8 0x936b 0x10fc 0x8ba0 0x9352 0x1150 0x8d97 0x9336 0x11ab 0x8f8f 0x9314 0x1212 0x9186 0x92f2 0x1280 0x937e 0x92c8 0x12fe 0x9575 0x9297 0x137c 0x976c 0x9265 0x13fa 0x9964 0x922e 0x148b 0x9b5b 0x91f4 0x1533 0x9d53 0x91b8 0x15dc 0x9f4a 0x9175 0x1695 0xa142 0x912a 0x1764 0xa339 0x90df 0x1854 0xa530 0x9098 0x195c 0xa728 0x905d 0x1a89 0xa91f 0x9034 0x1bf6 0xab17 0x9012 0x1db2 0xad0e 0x8ff1 0x1fce 0xaf06 0x8fc9 0x2259 0xb0fd 0x8f7a 0x2574 0xb2f5 0x8edc 0x2922 0xb4ec 0x8dc6 0x2d4e 0xb6e3 0x8c09 0x31d4 0xb8db 0x896f 0x3748 0xbad2 0x85c7 0x3b2e 0xbcca 0x821e 0x33e0 0xbec1 0x821e 0x33e0 0xc0b9 0x821e 0x33e0 0xc2b0 0x821e 0x33e0>;
			battery1_profile_t4_num = <0x64>;
			battery1_profile_t4_col = <0x03>;
			battery1_profile_t4 = <0x00 0xaa3c 0x2166 0x1f7 0xa9ad 0x2166 0x3ef 0xa8f6 0x2166 0x5e6 0xa845 0x2176 0x7de 0xa7a7 0x2179 0x9d5 0xa719 0x2158 0xbcd 0xa68b 0x211a 0xdc4 0xa604 0x2083 0xfbb 0xa585 0x1fac 0x11b3 0xa507 0x1edf 0x13aa 0xa48d 0x1e49 0x15a2 0xa418 0x1dee 0x1799 0xa3a3 0x1db3 0x1991 0xa336 0x1ddd 0x1b88 0xa2c3 0x1dd3 0x1d80 0xa24e 0x1dbd 0x1f77 0xa1d9 0x1da8 0x216e 0xa166 0x1d95 0x2366 0xa0f9 0x1d7a 0x255d 0xa08c 0x1d50 0x2755 0xa03d 0x1d72 0x294c 0x9fec 0x1dae 0x2b44 0x9f8f 0x1de4 0x2d3b 0x9f1f 0x1df2 0x2f32 0x9e94 0x1dbc 0x312a 0x9dec 0x1d3e 0x3321 0x9d34 0x1c98 0x3519 0x9c8f 0x1c1d 0x3710 0x9c02 0x1bd6 0x3908 0x9b88 0x1ba6 0x3aff 0x9b17 0x1b76 0x3cf6 0x9abb 0x1b76 0x3eee 0x9a6f 0x1b87 0x40e5 0x9a2a 0x1b9e 0x42dd 0x99dd 0x1b8e 0x44d4 0x998c 0x1b64 0x46cc 0x993f 0x1b3e 0x48c3 0x98eb 0x1b23 0x4abb 0x9897 0x1acf 0x4cb2 0x9843 0x1ad7 0x4ea9 0x97ef 0x1ad0 0x50a1 0x97a0 0x1ac2 0x5298 0x9755 0x1ac2 0x5490 0x970a 0x1ac3 0x5687 0x96c7 0x1add 0x587f 0x9684 0x1b04 0x5a76 0x9647 0x1b2e 0x5c6d 0x960c 0x1b58 0x5e65 0x95d1 0x1b82 0x605c 0x9597 0x1bae 0x6254 0x9565 0x1be8 0x644b 0x953a 0x1c3a 0x6643 0x9510 0x1c82 0x683a 0x94e6 0x1cc1 0x6a31 0x94bf 0x1cf6 0x6c29 0x949d 0x1d23 0x6e20 0x947c 0x1d66 0x7018 0x946a 0x1da2 0x720f 0x9453 0x1de3 0x7407 0x943f 0x1e39 0x75fe 0x942e 0x1ea0 0x77f5 0x941d 0x1f10 0x79ed 0x940c 0x1f8e 0x7be4 0x93fb 0x1ff3 0x7ddc 0x93f1 0x208d 0x7fd3 0x93e4 0x212b 0x81cb 0x93d3 0x21bf 0x83c2 0x93c0 0x224f 0x85ba 0x93a8 0x22e6 0x87b1 0x9397 0x238b 0x89a8 0x9386 0x2455 0x8ba0 0x9370 0x2517 0x8d97 0x9357 0x25db 0x8f8f 0x933e 0x26b6 0x9186 0x9324 0x27b0 0x937e 0x9303 0x2882 0x9575 0x92e1 0x2978 0x976c 0x92c0 0x2a8f 0x9964 0x9296 0x2ba1 0x9b5b 0x9266 0x2caf 0x9d53 0x923b 0x2dea 0x9f4a 0x9200 0x2ef6 0xa142 0x91cd 0x303f 0xa339 0x918f 0x3171 0xa530 0x914c 0x32a4 0xa728 0x9108 0x33e8 0xa91f 0x90c6 0x3538 0xab17 0x908c 0x3687 0xad0e 0x9059 0x37bf 0xaf06 0x9033 0x3928 0xb0fd 0x9011 0x3a98 0xb2f5 0x8fed 0x3c16 0xb4ec 0x8fbf 0x3dcb 0xb6e3 0x8f7b 0x3fd3 0xb8db 0x8ec5 0x41cb 0xbad2 0x8d40 0x4425 0xbcca 0x8b0b 0x46c4 0xbec1 0x87fc 0x428a 0xc0b9 0x83ae 0x380e 0xc2b0 0x83ae 0x380e>;
			serialnum_0 = "SB18C77591";
			battery0_name = "ATL_4V4_5000MAH";
			battery0_profile_t0_num = <0x64>;
			battery0_profile_t0_col = <0x03>;
			battery0_profile_t0 = <0x00 0xa9ce 0x3e8 0x1f0 0xa931 0x3e8 0x3e0 0xa8a7 0x3fc 0x5d0 0xa823 0x406 0x7c0 0xa7a2 0x406 0x9b0 0xa728 0x409 0xba0 0xa6b6 0x419 0xd90 0xa63a 0x41a 0xf80 0xa5be 0x40e 0x1171 0xa547 0x40e 0x1361 0xa4d3 0x41a 0x1551 0xa45f 0x41a 0x1741 0xa3eb 0x41a 0x1931 0xa378 0x41a 0x1b21 0xa304 0x41a 0x1d11 0xa295 0x425 0x1f01 0xa229 0x438 0x20f1 0xa1b5 0x438 0x22e1 0xa14a 0x438 0x24d1 0xa0de 0x438 0x26c1 0xa073 0x438 0x28b1 0xa007 0x438 0x2aa1 0x9f9d 0x43b 0x2c91 0x9f3a 0x44c 0x2e81 0x9ed7 0x44c 0x3072 0x9e75 0x45f 0x3262 0x9e12 0x46a 0x3452 0x9daf 0x462 0x3642 0x9d4c 0x44f 0x3832 0x9ce9 0x468 0x3a22 0x9c8d 0x46a 0x3c12 0x9c38 0x476 0x3e02 0x9be5 0x47e 0x3ff2 0x9b93 0x485 0x41e2 0x9b40 0x49c 0x43d2 0x9aed 0x49c 0x45c2 0x9aa3 0x4aa 0x47b2 0x9a54 0x4b5 0x49a2 0x9a04 0x4be 0x4b92 0x99b7 0x4c2 0x4d82 0x995b 0x4ba 0x4f72 0x98f0 0x4b2 0x5163 0x9871 0x482 0x5353 0x97f6 0x460 0x5543 0x978f 0x453 0x5733 0x973f 0x449 0x5923 0x96fe 0x439 0x5b13 0x96bc 0x421 0x5d03 0x9680 0x40e 0x5ef3 0x964a 0x40f 0x60e3 0x9619 0x41a 0x62d3 0x95e7 0x41a 0x64c3 0x95b5 0x41a 0x66b3 0x9584 0x41a 0x68a3 0x9558 0x41a 0x6a93 0x952f 0x41a 0x6c83 0x9506 0x41a 0x6e73 0x94dd 0x41b 0x7064 0x94bc 0x434 0x7254 0x949b 0x438 0x7444 0x947a 0x442 0x7634 0x9459 0x44c 0x7824 0x9438 0x44c 0x7a14 0x9417 0x44c 0x7c04 0x93fe 0x464 0x7df4 0x93e5 0x477 0x7fe4 0x93cc 0x47e 0x81d4 0x93b1 0x47e 0x83c4 0x938e 0x47c 0x85b4 0x935c 0x46b 0x87a4 0x9314 0x42d 0x8994 0x92cf 0x42c 0x8b84 0x9295 0x42c 0x8d74 0x9266 0x421 0x8f64 0x923d 0x438 0x9155 0x9213 0x438 0x9345 0x91ea 0x438 0x9535 0x91c7 0x438 0x9725 0x91a6 0x43f 0x9915 0x9185 0x44c 0x9b05 0x9163 0x44c 0x9cf5 0x912a 0x43b 0x9ee5 0x90f0 0x438 0xa0d5 0x90b6 0x438 0xa2c5 0x907c 0x43e 0xa4b5 0x903e 0x449 0xa6a5 0x8feb 0x439 0xa895 0x8fc0 0x438 0xaa85 0x8fb0 0x438 0xac75 0x8fa8 0x441 0xae65 0x8f9d 0x462 0xb056 0x8f8a 0x49c 0xb246 0x8f60 0x49c 0xb436 0x8ec8 0x49c 0xb626 0x8d7f 0x49c 0xb816 0x8ba3 0x4b0 0xba06 0x8937 0x4e4 0xbbf6 0x85f1 0x543 0xbde6 0x804a 0x675 0xbfd6 0x7f6c 0x6a4>;
			battery0_profile_t1_num = <0x64>;
			battery0_profile_t1_col = <0x03>;
			battery0_profile_t1 = <0x00 0xa9d8 0x532 0x1f0 0xa943 0x532 0x3e0 0xa8bb 0x53f 0x5d0 0xa83c 0x546 0x7c0 0xa7c0 0x546 0x9b0 0xa745 0x546 0xba0 0xa6cf 0x546 0xd90 0xa653 0x536 0xf80 0xa5de 0x532 0x1171 0xa56a 0x53b 0x1361 0xa4f6 0x546 0x1551 0xa482 0x544 0x1741 0xa40f 0x533 0x1931 0xa39b 0x532 0x1b21 0xa32d 0x53e 0x1d11 0xa2bd 0x546 0x1f01 0xa24c 0x54d 0x20f1 0xa1de 0x561 0x22e1 0xa16a 0x549 0x24d1 0xa0fe 0x55c 0x26c1 0xa092 0x564 0x28b1 0xa02b 0x56c 0x2aa1 0x9fc7 0x57f 0x2c91 0x9f65 0x596 0x2e81 0x9f0a 0x596 0x3072 0x9ea8 0x596 0x3262 0x9e44 0x5a1 0x3452 0x9dd9 0x5aa 0x3642 0x9d68 0x5b0 0x3832 0x9d05 0x5c8 0x3a22 0x9ca2 0x5c8 0x3c12 0x9c45 0x5d6 0x3e02 0x9bea 0x5dc 0x3ff2 0x9b96 0x5e6 0x41e2 0x9b4c 0x5fd 0x43d2 0x9b01 0x60e 0x45c2 0x9abf 0x637 0x47b2 0x9a70 0x640 0x49a2 0x9a1d 0x64e 0x4b92 0x99ca 0x65e 0x4d82 0x9971 0x653 0x4f72 0x98fd 0x611 0x5163 0x9881 0x5bf 0x5353 0x980c 0x56c 0x5543 0x97a5 0x53d 0x5733 0x9750 0x524 0x5923 0x9706 0x500 0x5b13 0x96c4 0x500 0x5d03 0x9691 0x50f 0x5ef3 0x965a 0x508 0x60e3 0x9623 0x500 0x62d3 0x95f1 0x500 0x64c3 0x95c0 0x502 0x66b3 0x9597 0x512 0x68a3 0x956e 0x514 0x6a93 0x9544 0x514 0x6c83 0x951b 0x514 0x6e73 0x94f4 0x514 0x7064 0x94d3 0x515 0x7254 0x94b1 0x52e 0x7444 0x9490 0x532 0x7634 0x9474 0x53c 0x7824 0x9458 0x546 0x7a14 0x9438 0x546 0x7c04 0x9420 0x547 0x7df4 0x9407 0x570 0x7fe4 0x93ee 0x56b 0x81d4 0x93d5 0x56e 0x83c4 0x93bc 0x578 0x85b4 0x93a2 0x575 0x87a4 0x9381 0x565 0x8994 0x9358 0x54c 0x8b84 0x9334 0x539 0x8d74 0x9313 0x532 0x8f64 0x92ef 0x529 0x9155 0x92c6 0x514 0x9345 0x929c 0x514 0x9535 0x927b 0x514 0x9725 0x925a 0x514 0x9915 0x9239 0x514 0x9b05 0x9215 0x51c 0x9cf5 0x91ea 0x532 0x9ee5 0x91b0 0x532 0xa0d5 0x9175 0x532 0xa2c5 0x913b 0x532 0xa4b5 0x90fd 0x532 0xa6a5 0x90b6 0x532 0xa895 0x9068 0x533 0xaa85 0x904f 0x544 0xac75 0x903e 0x546 0xae65 0x902d 0x556 0xb056 0x901d 0x576 0xb246 0x9006 0x5a0 0xb436 0x8fd8 0x5c8 0xb626 0x8f0f 0x5c8 0xb816 0x8d78 0x5d6 0xba06 0x8b51 0x610 0xbbf6 0x886a 0x685 0xbde6 0x83e9 0x86b 0xbfd6 0x7c10 0xf0a>;
			battery0_profile_t2_num = <0x64>;
			battery0_profile_t2_col = <0x03>;
			battery0_profile_t2 = <0x00 0xaa14 0x884 0x1f0 0xa977 0x884 0x3e0 0xa8e7 0x8a5 0x5d0 0xa864 0x8b6 0x7c0 0xa7e8 0x8ad 0x9b0 0xa76c 0x895 0xba0 0xa6f0 0x885 0xd90 0xa67c 0x894 0xf80 0xa609 0x898 0x1171 0xa592 0x890 0x1361 0xa519 0x884 0x1551 0xa4a5 0x882 0x1741 0xa431 0x869 0x1931 0xa3c5 0x866 0x1b21 0xa354 0x866 0x1d11 0xa2e4 0x872 0x1f01 0xa276 0x884 0x20f1 0xa203 0x884 0x22e1 0xa198 0x884 0x24d1 0xa12c 0x892 0x26c1 0xa0c1 0x898 0x28b1 0xa059 0x8a2 0x2aa1 0x9ff5 0x8b6 0x2c91 0x9f92 0x8b6 0x2e81 0x9f37 0x8c7 0x3072 0x9edd 0x8fd 0x3262 0x9e7e 0x931 0x3452 0x9e10 0x943 0x3642 0x9d8a 0x92c 0x3832 0x9cfe 0x91b 0x3a22 0x9c88 0x903 0x3c12 0x9c2c 0x91a 0x3e02 0x9bde 0x92e 0x3ff2 0x9b94 0x936 0x41e2 0x9b48 0x94a 0x43d2 0x9af6 0x931 0x45c2 0x9aab 0x944 0x47b2 0x9a61 0x94c 0x49a2 0x9a10 0x941 0x4b92 0x99b1 0x920 0x4d82 0x9945 0x8e6 0x4f72 0x98d1 0x8a4 0x5163 0x9864 0x869 0x5353 0x97fe 0x82a 0x5543 0x97a1 0x7fb 0x5733 0x9750 0x7e9 0x5923 0x9707 0x7d1 0x5b13 0x96c5 0x7d0 0x5d03 0x9689 0x7c4 0x5ef3 0x9653 0x7d2 0x60e3 0x9622 0x7ee 0x62d3 0x95f0 0x7ee 0x64c3 0x95be 0x7ee 0x66b3 0x9594 0x7fd 0x68a3 0x9565 0x802 0x6a93 0x9538 0x802 0x6c83 0x9511 0x809 0x6e73 0x94f0 0x821 0x7064 0x94cf 0x832 0x7254 0x94ad 0x849 0x7444 0x948c 0x85d 0x7634 0x946b 0x85f 0x7824 0x944c 0x85c 0x7a14 0x9433 0x884 0x7c04 0x9413 0x884 0x7df4 0x93ff 0x891 0x7fe4 0x93e5 0x88e 0x81d4 0x93ca 0x88a 0x83c4 0x93b9 0x89c 0x85b4 0x93a9 0x8b5 0x87a4 0x9398 0x8b6 0x8994 0x9381 0x8b6 0x8b84 0x9369 0x8b6 0x8d74 0x9350 0x8b6 0x8f64 0x9336 0x8b6 0x9155 0x9315 0x8b6 0x9345 0x92ec 0x8b6 0x9535 0x92c9 0x8c1 0x9725 0x92a8 0x8d6 0x9915 0x9285 0x8ec 0x9b05 0x925c 0x8fd 0x9cf5 0x922a 0x916 0x9ee5 0x91ea 0x91a 0xa0d5 0x91ad 0x934 0xa2c5 0x9174 0x95d 0xa4b5 0x9134 0x982 0xa6a5 0x90e2 0x992 0xa895 0x9097 0x9ab 0xaa85 0x906e 0x9d0 0xac75 0x9057 0xa1a 0xae65 0x9046 0xa86 0xb056 0x9033 0xb02 0xb246 0x9012 0xb7e 0xb436 0x8fd2 0xc47 0xb626 0x8f00 0xcec 0xb816 0x8d80 0xdb4 0xba06 0x8b53 0xef8 0xbbf6 0x8876 0x1114 0xbde6 0x842a 0x14cb 0xbfd6 0x83ae 0x1536>;
			battery0_profile_t3_num = <0x64>;
			battery0_profile_t3_col = <0x03>;
			battery0_profile_t3 = <0x00 0xa924 0xd02 0x1f0 0xa86e 0xd02 0x3e0 0xa7d2 0xd0f 0x5d0 0xa747 0xd24 0x7c0 0xa6c6 0xd34 0x9b0 0xa64c 0xd37 0xba0 0xa5da 0xd47 0xd90 0xa55e 0xd48 0xf80 0xa4e8 0xd48 0x1171 0xa475 0xd48 0x1361 0xa401 0xd48 0x1551 0xa38d 0xd48 0x1741 0xa319 0xd48 0x1931 0xa2ad 0xd5e 0x1b21 0xa241 0xd71 0x1d11 0xa1d3 0xd7a 0x1f01 0xa163 0xd80 0x20f1 0xa0f7 0xd98 0x22e1 0xa08c 0xd98 0x24d1 0xa027 0xd98 0x26c1 0x9fc9 0xdb1 0x28b1 0x9f71 0xdeb 0x2aa1 0x9f1d 0xe39 0x2c91 0x9ec2 0xe73 0x2e81 0x9e4f 0xe74 0x3072 0x9dc3 0xe55 0x3262 0x9d30 0xe2c 0x3452 0x9ca3 0xe0b 0x3642 0x9c2a 0xdfe 0x3832 0x9bc7 0xe0f 0x3a22 0x9b7a 0xe27 0x3c12 0x9b36 0xe3a 0x3e02 0x9aef 0xe3a 0x3ff2 0x9aa3 0xe27 0x41e2 0x9a50 0xe10 0x43d2 0x99fd 0xe10 0x45c2 0x99a4 0xdec 0x47b2 0x9944 0xdc3 0x49a2 0x98de 0xd93 0x4b92 0x9873 0xd58 0x4d82 0x9808 0xd16 0x4f72 0x97ad 0xcec 0x5163 0x975f 0xce4 0x5353 0x9714 0xce4 0x5543 0x96cd 0xce4 0x5733 0x968c 0xce4 0x5923 0x9652 0xce4 0x5b13 0x9619 0xce4 0x5d03 0x95e5 0xcf7 0x5ef3 0x95b4 0xd18 0x60e3 0x9585 0xd39 0x62d3 0x955c 0xd4a 0x64c3 0x9533 0xd63 0x66b3 0x9509 0xd75 0x68a3 0x94e6 0xd8b 0x6a93 0x94c1 0xda0 0x6c83 0x9499 0xdb7 0x6e73 0x9478 0xdde 0x7064 0x9457 0xdde 0x7254 0x943d 0xe01 0x7444 0x9424 0xe2a 0x7634 0x940c 0xe4c 0x7824 0x93f5 0xe69 0x7a14 0x93e4 0xe91 0x7c04 0x93d4 0xea2 0x7df4 0x93c3 0xec6 0x7fe4 0x93b3 0xefd 0x81d4 0x93a2 0xf37 0x83c4 0x9392 0xf66 0x85b4 0x9381 0xfb9 0x87a4 0x9369 0xfcd 0x8994 0x9350 0x100e 0x8b84 0x9333 0x1043 0x8d74 0x9312 0x106d 0x8f64 0x92f1 0x10be 0x9155 0x92d0 0x10f8 0x9345 0x92a7 0x1147 0x9535 0x927e 0x11aa 0x9725 0x924e 0x1211 0x9915 0x9214 0x127a 0x9b05 0x91da 0x12f5 0x9cf5 0x9198 0x1361 0x9ee5 0x9156 0x13e7 0xa0d5 0x9109 0x1479 0xa2c5 0x90ba 0x1514 0xa4b5 0x9078 0x15ca 0xa6a5 0x9057 0x16c2 0xa895 0x903e 0x17e2 0xaa85 0x901e 0x1924 0xac75 0x8ff9 0x1aa6 0xae65 0x8fbe 0x1c77 0xb056 0x8f4d 0x1e89 0xb246 0x8e34 0x20a2 0xb436 0x8c47 0x23b5 0xb626 0x89a9 0x28ac 0xb816 0x85f7 0x3045 0xba06 0x8318 0x364c 0xbbf6 0x8318 0x364c 0xbde6 0x8318 0x364c 0xbfd6 0x8318 0x364c>;
			battery0_profile_t4_num = <0x64>;
			battery0_profile_t4_col = <0x03>;
			battery0_profile_t4 = <0x00 0xaa14 0x1fa4 0x1f0 0xa987 0x1fa4 0x3e0 0xa8da 0x1fa4 0x5d0 0xa838 0x1fbc 0x7c0 0xa7a6 0x1fc1 0x9b0 0xa71c 0x1f90 0xba0 0xa6a2 0x1f90 0xd90 0xa626 0x1f43 0xf80 0xa5aa 0x1ede 0x1171 0xa52e 0x1e6a 0x1361 0xa4b5 0x1dee 0x1551 0xa441 0x1d7a 0x1741 0xa3cd 0x1d51 0x1931 0xa361 0x1d4c 0x1b21 0xa2f0 0x1d4c 0x1d11 0xa280 0x1d44 0x1f01 0xa212 0x1d38 0x20f1 0xa19f 0x1d37 0x22e1 0xa134 0x1d1e 0x24d1 0xa0c8 0x1d0c 0x26c1 0xa062 0x1cf6 0x28b1 0xa002 0x1cf2 0x2aa1 0x9fa5 0x1d06 0x2c91 0x9f42 0x1d06 0x2e81 0x9ed8 0x1d16 0x3072 0x9e5a 0x1ced 0x3262 0x9dc8 0x1c8f 0x3452 0x9d2e 0x1c21 0x3642 0x9c9a 0x1bce 0x3832 0x9c0e 0x1b7c 0x3a22 0x9b91 0x1b38 0x3c12 0x9b26 0x1b26 0x3e02 0x9acc 0x1b26 0x3ff2 0x9a79 0x1b1a 0x41e2 0x9a27 0x1af2 0x43d2 0x99dd 0x1ae2 0x45c2 0x998b 0x1aa6 0x47b2 0x993e 0x1a85 0x49a2 0x98f0 0x1a5d 0x4b92 0x989d 0x1a21 0x4d82 0x984a 0x19f9 0x4f72 0x97f9 0x19e9 0x5163 0x97ad 0x19e6 0x5353 0x9763 0x19e6 0x5543 0x971c 0x19ed 0x5733 0x96da 0x19fa 0x5923 0x9697 0x19fa 0x5b13 0x965d 0x1a3b 0x5d03 0x9624 0x1a6a 0x5ef3 0x95ea 0x1a85 0x60e3 0x95b6 0x1aad 0x62d3 0x958b 0x1afa 0x64c3 0x9559 0x1b23 0x66b3 0x9528 0x1b63 0x68a3 0x94fc 0x1b94 0x6a93 0x94d7 0x1bc5 0x6c83 0x94b4 0x1bf5 0x6e73 0x948c 0x1c12 0x7064 0x9473 0x1c65 0x7254 0x945b 0x1ca2 0x7444 0x9442 0x1ce1 0x7634 0x942d 0x1d3d 0x7824 0x941a 0x1daf 0x7a14 0x9402 0x1e02 0x7c04 0x93f1 0x1e66 0x7df4 0x93e1 0x1edd 0x7fe4 0x93d0 0x1f59 0x81d4 0x93bc 0x1fce 0x83c4 0x93a5 0x203d 0x85b4 0x9394 0x20b9 0x87a4 0x937c 0x2135 0x8994 0x9363 0x21b0 0x8b84 0x934f 0x2241 0x8d74 0x933c 0x22e6 0x8f64 0x9322 0x2389 0x9155 0x9301 0x2415 0x9345 0x92e0 0x24cf 0x9535 0x92bf 0x2587 0x9725 0x929a 0x2649 0x9915 0x9270 0x271f 0x9b05 0x9247 0x2807 0x9cf5 0x9215 0x28ff 0x9ee5 0x91dd 0x29f4 0xa0d5 0x91a3 0x2b0f 0xa2c5 0x9166 0x2c44 0xa4b5 0x9122 0x2d86 0xa6a5 0x90d8 0x2ee1 0xa895 0x909e 0x307e 0xaa85 0x906b 0x323d 0xac75 0x9043 0x342a 0xae65 0x9022 0x363f 0xb056 0x8ffe 0x383e 0xb246 0x8fcc 0x395f 0xb436 0x8f7c 0x3a6c 0xb626 0x8ec4 0x3b94 0xb816 0x8d65 0x3ca8 0xba06 0x8b52 0x3df6 0xbbf6 0x8871 0x3fb7 0xbde6 0x8453 0x4684 0xbfd6 0x8444 0x46b4>;
		};
	};

	fragment@45 {
		target = <0xffffffff>;

		__overlay__ {
			compatible = "mmi,moto-chg-tcmd";
			status = "okay";
			mmi,ntc_table = <0x01>;
			mmi,ntc_v_ref = <0x1b7740>;
			mmi,ntc_r_pull = <0x186a0>;
		};
	};

	fragment@46 {
		target = <0xffffffff>;

		__overlay__ {

			led@7 {
				compatible = "mediatek,charging";
				led_mode = <0x03>;
				phandle = <0x58>;
			};

			usb_phy_init {
				compatible = "mediatek,phy_tuning";
				u2_vrt_ref = <0x07>;
				u2_term_ref = <0x03>;
				u2_enhance = <0x03>;
				status = "okay";
				phandle = <0x59>;
			};
		};
	};

	fragment@47 {
		target = <0xffffffff>;

		__overlay__ {

			lcm_rst_out0_gpio {
				phandle = <0x46>;

				pins_cmd_dat {
					pinmux = <0x2d00>;
					slew-rate = <0x01>;
					output-low;
				};
			};

			lcm_rst_out1_gpio {
				phandle = <0x47>;

				pins_cmd_dat {
					pinmux = <0x2d00>;
					slew-rate = <0x01>;
					output-high;
				};
			};

			lcd_bias_enp0_gpio {
				phandle = <0x48>;

				pins_cmd_dat {
					pinmux = <0x1000>;
					slew-rate = <0x01>;
					output-low;
				};
			};

			lcd_bias_enp1_gpio {
				phandle = <0x49>;

				pins_cmd_dat {
					pinmux = <0x1000>;
					slew-rate = <0x01>;
					output-high;
				};
			};

			lcd_bias_enn0_gpio {
				phandle = <0x4a>;

				pins_cmd_dat {
					pinmux = <0xd00>;
					slew-rate = <0x01>;
					output-low;
				};
			};

			lcd_bias_enn1_gpio {
				phandle = <0x4b>;

				pins_cmd_dat {
					pinmux = <0xd00>;
					slew-rate = <0x01>;
					output-high;
				};
			};

			lcm_pwr_en_out0_gpio {
				phandle = <0x4c>;

				pins_cmd_dat {
					pinmux = <0xa500>;
					slew-rate = <0x01>;
					output-low;
				};
			};

			lcm_pwr_en_out1_gpio {
				phandle = <0x4d>;

				pins_cmd_dat {
					pinmux = <0xa500>;
					slew-rate = <0x01>;
					output-high;
				};
			};

			dispdefault {
				phandle = <0x45>;
			};
		};
	};

	fragment@48 {
		target = <0xffffffff>;

		__overlay__ {
			pinctrl-names = "dispdefault\0lcm_rst_out0_gpio\0lcm_rst_out1_gpio\0lcd_bias_enp0_gpio\0lcd_bias_enp1_gpio\0lcd_bias_enn0_gpio\0lcd_bias_enn1_gpio\0lcm_pwr_en_out0_gpio\0lcm_pwr_en_out1_gpio";
			pinctrl-0 = <0x45>;
			pinctrl-1 = <0x46>;
			pinctrl-2 = <0x47>;
			pinctrl-3 = <0x48>;
			pinctrl-4 = <0x49>;
			pinctrl-5 = <0x4a>;
			pinctrl-6 = <0x4b>;
			pinctrl-7 = <0x4c>;
			pinctrl-8 = <0x4d>;
			status = "okay";
		};
	};

	fragment@49 {
		target = <0xffffffff>;

		__overlay__ {

			fs16xx@34 {
				compatible = "foursemi,fs16xx";
				reg = <0x34>;
				fsm,re25-dft = <0x1c00>;
				status = "okay";
			};

			i2c_lcd_bias@3e {
				compatible = "mediatek,i2c_lcd_bias";
				reg = <0x3e>;
				status = "okay";
			};
		};
	};

	fragment@50 {
		target = <0xffffffff>;

		__overlay__ {
			min-volt = <0x2dc6c0>;
		};
	};

	fragment@51 {
		target = <0xffffffff>;

		__overlay__ {
			cd_level = [01];
		};
	};

	fragment@model {
		target-path = "/";

		__overlay__ {
			mot,model = "tonga";
			mot,board-id = <0x42 0xa100>;
		};
	};

	fragment@52 {
		target = <0xffffffff>;

		__overlay__ {

			adc_channel@ {
				compatible = "mediatek,adc_channel";
				mediatek,temperature0 = <0x00>;
				mediatek,temperature1 = <0x01>;
				mediatek,adc_fdd_rf_params_dynamic_custom_ch = <0x02>;
				status = "okay";
			};
		};
	};

	fragment@53 {
		target = <0xffffffff>;

		__overlay__ {
			io-channels = <0xffffffff 0x02>;
		};
	};

	fragment@54 {
		target = <0xffffffff>;

		__overlay__ {
			mediatek,clkbuf-quantity = <0x07>;
			mediatek,clkbuf-config = <0x02 0x01 0x01 0x02 0x00 0x00 0x00>;
			mediatek,clkbuf-driving-current = <0x01 0x01 0x01 0x01 0x01 0x01 0x01>;
			status = "okay";
		};
	};

	fragment@55 {
		target = <0xffffffff>;

		__overlay__ {
			#address-cells = <0x01>;
			#size-cells = <0x00>;
			clock-frequency = <0x61a80>;
			mediatek,use-push-pull;

			i2c_lcd_bias@3e {
				compatible = "mediatek,i2c_lcd_bias";
				reg = <0x3e>;
				status = "okay";
				phandle = <0x5a>;
			};
		};
	};

	fragment@56 {
		target = <0xffffffff>;

		__overlay__ {
			#address-cells = <0x01>;
			#size-cells = <0x00>;
			clock-frequency = <0x61a80>;
			mediatek,use-open-drain;
		};
	};

	fragment@57 {
		target = <0xffffffff>;

		__overlay__ {
			#address-cells = <0x01>;
			#size-cells = <0x00>;
			clock-frequency = <0x61a80>;
			mediatek,use-open-drain;

			camera_main@40 {
				compatible = "mediatek,camera_main";
				reg = <0x40>;
				status = "okay";
				phandle = <0x5b>;
			};

			camera_main_eeprom@50 {
				compatible = "mediatek,camera_main_eeprom";
				reg = <0x50>;
				status = "okay";
				phandle = <0x5c>;
			};

			camera_main_af@18 {
				compatible = "mediatek,camera_main_af";
				reg = <0x18>;
				status = "okay";
				phandle = <0x5d>;
			};

			ccu_sensor_i2c_2_hw@10 {
				compatible = "mediatek,ccu_sensor_i2c_2_hw";
				reg = <0x10>;
				status = "okay";
				phandle = <0x5e>;
			};

			camera_main_three@6e {
				compatible = "mediatek,camera_main_three";
				reg = <0x6e>;
				status = "okay";
				phandle = <0x5f>;
			};
		};
	};

	fragment@58 {
		target = <0xffffffff>;

		__overlay__ {
			#address-cells = <0x01>;
			#size-cells = <0x00>;
			clock-frequency = <0x61a80>;
			mediatek,use-open-drain;

			speaker_amp@34 {
				compatible = "mediatek,speaker_amp";
				reg = <0x34>;
				status = "okay";
				phandle = <0x60>;
			};

			slave_charger@4b {
				compatible = "mediatek,slave_charger";
				reg = <0x4b>;
				status = "okay";
				phandle = <0x61>;
			};

			nfc@08 {
				compatible = "mediatek,nfc";
				reg = <0x08>;
				status = "okay";
				phandle = <0x62>;
			};

			ext_buck_lp4@57 {
				compatible = "mediatek,ext_buck_lp4";
				reg = <0x57>;
				status = "okay";
				phandle = <0x63>;
			};

			ext_buck_lp4x@50 {
				compatible = "mediatek,ext_buck_lp4x";
				reg = <0x50>;
				status = "okay";
				phandle = <0x64>;
			};
		};
	};

	fragment@59 {
		target = <0xffffffff>;

		__overlay__ {
			#address-cells = <0x01>;
			#size-cells = <0x00>;
			clock-frequency = <0x61a80>;
			mediatek,use-open-drain;

			camera_main_two@7a {
				compatible = "mediatek,camera_main_two";
				reg = <0x7a>;
				status = "okay";
				phandle = <0x65>;
			};

			camera_main_two_eeprom@50 {
				compatible = "mediatek,camera_main_two_eeprom";
				reg = <0x50>;
				status = "okay";
				phandle = <0x66>;
			};

			camera_sub@2d {
				compatible = "mediatek,camera_sub";
				reg = <0x2d>;
				status = "okay";
				phandle = <0x67>;
			};

			camera_sub_eeprom@54 {
				compatible = "mediatek,camera_sub_eeprom";
				reg = <0x54>;
				status = "okay";
				phandle = <0x68>;
			};

			ccu_sensor_i2c_4_hw@11 {
				compatible = "mediatek,ccu_sensor_i2c_4_hw";
				reg = <0x11>;
				status = "okay";
				phandle = <0x69>;
			};
		};
	};

	fragment@60 {
		target = <0xffffffff>;

		__overlay__ {
			#address-cells = <0x01>;
			#size-cells = <0x00>;
			clock-frequency = <0x61a80>;
			mediatek,use-open-drain;

			subpmic_pmu@34 {
				compatible = "mediatek,subpmic_pmu";
				reg = <0x34>;
				status = "okay";
				phandle = <0x6a>;
			};

			usb_type_c@4e {
				compatible = "mediatek,usb_type_c";
				reg = <0x4e>;
				status = "okay";
				phandle = <0x6b>;
			};

			usb_type_c_sgm@47 {
				compatible = "mediatek,usb_type_c_sgm";
				reg = <0x47>;
				status = "okay";
				phandle = <0x6c>;
			};
		};
	};

	fragment@61 {
		target = <0xffffffff>;

		__overlay__ {
			#address-cells = <0x01>;
			#size-cells = <0x00>;
			clock-frequency = <0x61a80>;
			mediatek,use-open-drain;

			camera_main_two_af@0c {
				compatible = "mediatek,camera_main_two_af";
				reg = <0x0c>;
				status = "okay";
				phandle = <0x6d>;
			};

			ext_buck_vgpu@55 {
				compatible = "mediatek,ext_buck_vgpu";
				reg = <0x55>;
				status = "okay";
				phandle = <0x6e>;
			};
		};
	};

	fragment@62 {
		target = <0xffffffff>;

		__overlay__ {
			#address-cells = <0x01>;
			#size-cells = <0x00>;
			clock-frequency = <0x61a80>;
			mediatek,use-open-drain;
		};
	};

	fragment@63 {
		target = <0xffffffff>;

		__overlay__ {
			#address-cells = <0x01>;
			#size-cells = <0x00>;
			clock-frequency = <0x61a80>;
			mediatek,use-open-drain;
		};
	};

	fragment@64 {
		target = <0xffffffff>;

		__overlay__ {
			#address-cells = <0x01>;
			#size-cells = <0x00>;
			clock-frequency = <0x61a80>;
			mediatek,use-open-drain;
		};
	};

	fragment@65 {
		target = <0xffffffff>;

		__overlay__ {
			GPIO_SIM2_SIO = <0xffffffff 0x23 0x00>;
			GPIO_SIM2_SRST = <0xffffffff 0x24 0x00>;
			GPIO_SIM2_SCLK = <0xffffffff 0x25 0x00>;
			GPIO_SIM1_SCLK = <0xffffffff 0x26 0x00>;
			GPIO_SIM1_SRST = <0xffffffff 0x27 0x00>;
			GPIO_SIM1_SIO = <0xffffffff 0x28 0x00>;
			GPIO_SIM1_HOT_PLUG = <0xffffffff 0x2f 0x00>;
		};
	};

	fragment@66 {
		target = <0xffffffff>;

		__overlay__ {
			gpio_init_default = <0x00 0x00 0x00 0x00 0x01 0x01 0x01 0x01 0x00 0x00 0x00 0x00 0x00 0x01 0x02 0x00 0x00 0x00 0x01 0x01 0x01 0x03 0x00 0x00 0x00 0x01 0x01 0x01 0x04 0x02 0x00 0x00 0x01 0x00 0x00 0x05 0x02 0x01 0x00 0x00 0x00 0x00 0x06 0x02 0x01 0x00 0x00 0x00 0x00 0x07 0x02 0x01 0x00 0x00 0x00 0x00 0x08 0x07 0x00 0x00 0x01 0x01 0x00 0x09 0x00 0x00 0x00 0x01 0x01 0x00 0x0a 0x00 0x00 0x00 0x00 0x00 0x00 0x0b 0x00 0x00 0x00 0x01 0x01 0x00 0x0c 0x00 0x00 0x00 0x01 0x00 0x00 0x0d 0x00 0x01 0x00 0x01 0x01 0x00 0x0e 0x00 0x00 0x00 0x01 0x00 0x00 0x0f 0x00 0x00 0x00 0x01 0x01 0x00 0x10 0x00 0x01 0x00 0x01 0x01 0x00 0x11 0x06 0x00 0x00 0x01 0x00 0x00 0x12 0x06 0x01 0x00 0x00 0x00 0x00 0x13 0x06 0x01 0x00 0x00 0x00 0x00 0x14 0x06 0x01 0x00 0x00 0x00 0x00 0x15 0x01 0x00 0x00 0x00 0x00 0x00 0x16 0x01 0x00 0x00 0x00 0x00 0x00 0x17 0x01 0x01 0x00 0x00 0x00 0x00 0x18 0x01 0x01 0x00 0x00 0x00 0x00 0x19 0x01 0x00 0x00 0x01 0x01 0x00 0x1a 0x01 0x01 0x00 0x00 0x00 0x00 0x1b 0x01 0x01 0x00 0x00 0x00 0x00 0x1c 0x01 0x01 0x00 0x01 0x01 0x00 0x1d 0x01 0x01 0x00 0x00 0x00 0x01 0x1e 0x01 0x00 0x00 0x01 0x01 0x01 0x1f 0x01 0x00 0x00 0x01 0x01 0x01 0x20 0x01 0x00 0x00 0x01 0x01 0x01 0x21 0x01 0x00 0x00 0x01 0x01 0x01 0x22 0x01 0x00 0x00 0x01 0x01 0x01 0x23 0x01 0x00 0x00 0x01 0x01 0x00 0x24 0x01 0x01 0x00 0x00 0x00 0x00 0x25 0x01 0x01 0x00 0x00 0x00 0x00 0x26 0x01 0x01 0x00 0x00 0x00 0x00 0x27 0x01 0x01 0x00 0x00 0x00 0x00 0x28 0x01 0x00 0x00 0x01 0x01 0x00 0x29 0x00 0x00 0x00 0x01 0x00 0x00 0x2a 0x00 0x00 0x00 0x01 0x01 0x00 0x2b 0x01 0x01 0x00 0x00 0x00 0x00 0x2c 0x01 0x00 0x00 0x01 0x00 0x00 0x2d 0x01 0x01 0x00 0x00 0x00 0x00 0x2e 0x00 0x00 0x00 0x01 0x00 0x00 0x2f 0x01 0x00 0x00 0x01 0x01 0x00 0x30 0x01 0x00 0x00 0x01 0x01 0x01 0x31 0x01 0x00 0x00 0x01 0x01 0x01 0x32 0x01 0x00 0x00 0x01 0x01 0x01 0x33 0x01 0x00 0x00 0x01 0x01 0x01 0x34 0x01 0x01 0x00 0x01 0x00 0x00 0x35 0x01 0x01 0x00 0x01 0x00 0x00 0x36 0x01 0x01 0x00 0x01 0x00 0x00 0x37 0x01 0x01 0x00 0x01 0x00 0x00 0x38 0x01 0x01 0x00 0x01 0x00 0x00 0x39 0x01 0x01 0x00 0x01 0x00 0x00 0x3a 0x00 0x00 0x00 0x01 0x00 0x00 0x3b 0x01 0x00 0x00 0x01 0x00 0x00 0x3c 0x01 0x00 0x00 0x01 0x00 0x00 0x3d 0x01 0x00 0x00 0x01 0x00 0x00 0x3e 0x01 0x00 0x00 0x01 0x00 0x00 0x3f 0x01 0x00 0x00 0x01 0x00 0x00 0x40 0x01 0x00 0x00 0x01 0x00 0x00 0x41 0x01 0x00 0x00 0x01 0x00 0x00 0x42 0x01 0x00 0x00 0x01 0x00 0x00 0x43 0x01 0x00 0x00 0x01 0x00 0x00 0x44 0x01 0x00 0x00 0x01 0x00 0x00 0x45 0x00 0x00 0x00 0x00 0x00 0x00 0x46 0x01 0x01 0x00 0x01 0x00 0x00 0x47 0x01 0x01 0x00 0x01 0x00 0x00 0x48 0x01 0x01 0x00 0x01 0x00 0x00 0x49 0x01 0x01 0x00 0x01 0x00 0x00 0x4a 0x01 0x01 0x00 0x01 0x00 0x00 0x4b 0x01 0x01 0x00 0x01 0x00 0x00 0x4c 0x01 0x01 0x00 0x01 0x00 0x00 0x4d 0x01 0x01 0x00 0x01 0x00 0x00 0x4e 0x01 0x01 0x00 0x01 0x00 0x00 0x4f 0x01 0x00 0x00 0x01 0x00 0x00 0x50 0x01 0x00 0x00 0x01 0x00 0x00 0x51 0x01 0x00 0x00 0x01 0x01 0x01 0x52 0x01 0x00 0x00 0x01 0x01 0x01 0x53 0x01 0x00 0x00 0x01 0x01 0x01 0x54 0x01 0x00 0x00 0x01 0x01 0x01 0x55 0x01 0x01 0x00 0x01 0x00 0x00 0x56 0x01 0x01 0x00 0x01 0x00 0x00 0x57 0x00 0x01 0x00 0x00 0x00 0x00 0x58 0x01 0x01 0x00 0x00 0x00 0x00 0x59 0x01 0x00 0x00 0x01 0x00 0x00 0x5a 0x00 0x00 0x00 0x01 0x00 0x00 0x5b 0x00 0x01 0x00 0x01 0x00 0x00 0x5c 0x00 0x01 0x00 0x00 0x00 0x00 0x5d 0x01 0x00 0x00 0x01 0x01 0x00 0x5e 0x01 0x00 0x00 0x01 0x01 0x00 0x5f 0x01 0x00 0x00 0x01 0x01 0x00 0x60 0x01 0x01 0x00 0x00 0x00 0x00 0x61 0x00 0x00 0x00 0x01 0x00 0x00 0x62 0x00 0x01 0x00 0x00 0x00 0x00 0x63 0x01 0x01 0x00 0x00 0x00 0x00 0x64 0x01 0x01 0x00 0x00 0x00 0x00 0x65 0x00 0x01 0x00 0x00 0x00 0x00 0x66 0x00 0x01 0x00 0x00 0x00 0x00 0x67 0x01 0x00 0x00 0x01 0x01 0x01 0x68 0x01 0x00 0x00 0x01 0x01 0x01 0x69 0x01 0x00 0x00 0x01 0x01 0x01 0x6a 0x01 0x00 0x00 0x01 0x01 0x01 0x6b 0x00 0x00 0x00 0x01 0x00 0x00 0x6c 0x01 0x01 0x00 0x00 0x00 0x00 0x6d 0x00 0x01 0x00 0x00 0x00 0x00 0x6e 0x01 0x00 0x00 0x01 0x00 0x00 0x6f 0x01 0x00 0x00 0x01 0x00 0x00 0x70 0x01 0x00 0x00 0x01 0x00 0x00 0x71 0x00 0x00 0x00 0x01 0x00 0x00 0x72 0x00 0x00 0x00 0x01 0x00 0x00 0x73 0x00 0x00 0x00 0x01 0x00 0x00 0x74 0x00 0x00 0x00 0x01 0x00 0x00 0x75 0x00 0x00 0x00 0x01 0x00 0x00 0x76 0x00 0x00 0x00 0x01 0x00 0x00 0x77 0x00 0x00 0x00 0x01 0x00 0x00 0x78 0x00 0x00 0x00 0x01 0x00 0x00 0x79 0x00 0x00 0x00 0x01 0x00 0x00 0x7a 0x01 0x00 0x00 0x01 0x01 0x01 0x7b 0x01 0x00 0x00 0x01 0x01 0x01 0x7c 0x01 0x01 0x00 0x00 0x00 0x01 0x7d 0x01 0x00 0x00 0x01 0x01 0x01 0x7e 0x01 0x00 0x00 0x01 0x01 0x01 0x7f 0x01 0x00 0x00 0x01 0x01 0x01 0x80 0x01 0x00 0x00 0x01 0x01 0x01 0x81 0x01 0x00 0x00 0x01 0x01 0x01 0x82 0x01 0x00 0x00 0x01 0x01 0x01 0x83 0x01 0x00 0x00 0x01 0x00 0x01 0x84 0x01 0x00 0x00 0x01 0x01 0x01 0x85 0x01 0x01 0x01 0x00 0x00 0x01 0x86 0x01 0x00 0x00 0x01 0x00 0x01 0x87 0x01 0x01 0x00 0x00 0x00 0x00 0x88 0x01 0x01 0x00 0x00 0x00 0x00 0x89 0x01 0x01 0x00 0x00 0x00 0x00 0x8a 0x01 0x01 0x00 0x00 0x00 0x00 0x8b 0x01 0x01 0x00 0x00 0x00 0x00 0x8c 0x01 0x00 0x00 0x01 0x00 0x00 0x8d 0x01 0x00 0x00 0x01 0x00 0x00 0x8e 0x01 0x00 0x00 0x01 0x00 0x00 0x8f 0x01 0x00 0x00 0x01 0x00 0x00 0x90 0x01 0x00 0x00 0x01 0x00 0x00 0x91 0x01 0x01 0x01 0x00 0x00 0x00 0x92 0x01 0x00 0x00 0x01 0x00 0x00 0x93 0x01 0x01 0x00 0x00 0x00 0x00 0x94 0x01 0x01 0x00 0x00 0x00 0x00 0x95 0x01 0x01 0x00 0x00 0x00 0x00 0x96 0x03 0x01 0x00 0x01 0x01 0x00 0x97 0x03 0x01 0x00 0x00 0x00 0x00 0x98 0x03 0x01 0x00 0x01 0x01 0x00 0x99 0x00 0x01 0x00 0x00 0x00 0x00 0x9a 0x00 0x01 0x00 0x00 0x00 0x00 0x9b 0x07 0x01 0x00 0x00 0x00 0x00 0x9c 0x07 0x00 0x00 0x01 0x00 0x00 0x9d 0x07 0x00 0x00 0x01 0x00 0x00 0x9e 0x07 0x00 0x00 0x01 0x00 0x00 0x9f 0x00 0x01 0x01 0x00 0x00 0x00 0xa0 0x00 0x00 0x00 0x01 0x00 0x00 0xa1 0x01 0x00 0x00 0x01 0x01 0x01 0xa2 0x01 0x00 0x00 0x01 0x01 0x01 0xa3 0x00 0x00 0x00 0x00 0x00 0x00 0xa4 0x00 0x01 0x00 0x00 0x00 0x00 0xa5 0x00 0x01 0x01 0x01 0x01 0x00 0xa6 0x00 0x00 0x00 0x01 0x00 0x00 0xa7 0x00 0x00 0x00 0x01 0x00 0x00 0xa8 0x00 0x00 0x00 0x01 0x00 0x00 0xa9 0x00 0x00 0x00 0x01 0x00 0x00 0xaa 0x00 0x01 0x00 0x00 0x00 0x00 0xab 0x00 0x00 0x00 0x01 0x00 0x00 0xac 0x00 0x00 0x00 0x01 0x00 0x00 0xad 0x00 0x01 0x00 0x00 0x00 0x00 0xae 0x00 0x00 0x00 0x01 0x00 0x00 0xaf 0x00 0x01 0x01 0x00 0x00 0x00 0xb0 0x00 0x00 0x00 0x01 0x00 0x00 0xb1 0x00 0x01 0x00 0x00 0x00 0x00 0xb2 0x00 0x00 0x00 0x01 0x00 0x00 0xb3 0x00 0x00 0x00 0x01 0x00 0x00>;
		};
	};

	fragment@67 {
		target = <0xffffffff>;

		__overlay__ {
			interrupt-parent = <0xffffffff>;
			interrupts = <0x01 0x02 0x01 0x00>;
			status = "okay";
		};
	};

	fragment@68 {
		target = <0xffffffff>;

		__overlay__ {
			interrupt-parent = <0xffffffff>;
			interrupts = <0x02 0x08 0x02 0x00>;
			deb-gpios = <0xffffffff 0x02 0x00>;
			debounce = <0x7d000>;
			status = "okay";
		};
	};

	fragment@69 {
		target = <0xffffffff>;

		__overlay__ {
			interrupt-parent = <0xffffffff>;
			interrupts = <0x0a 0x02 0x0a 0x00>;
			status = "okay";
		};
	};

	fragment@70 {
		target = <0xffffffff>;

		__overlay__ {
			interrupt-parent = <0xffffffff>;
			interrupts = <0x0b 0x02 0x0b 0x00>;
			status = "okay";
		};
	};

	fragment@71 {
		target = <0xffffffff>;

		__overlay__ {
			interrupt-parent = <0xffffffff>;
			interrupts = <0x0e 0x01 0x0e 0x00>;
			status = "okay";
		};
	};

	fragment@72 {
		target = <0xffffffff>;

		__overlay__ {
			interrupt-parent = <0xffffffff>;
			interrupts = <0x2a 0x02 0x2a 0x00>;
			status = "okay";
		};
	};

	fragment@73 {
		target = <0xffffffff>;

		__overlay__ {
			interrupt-parent = <0xffffffff>;
			interrupts = <0x2c 0x01 0x2c 0x01>;
			status = "okay";
		};
	};

	fragment@74 {
		target = <0xffffffff>;

		__overlay__ {
			interrupt-parent = <0xffffffff>;
			interrupts = <0x45 0x04 0x45 0x00>;
			deb-gpios = <0xffffffff 0x45 0x00>;
			debounce = <0x7d000>;
			status = "okay";
		};
	};

	fragment@75 {
		target = <0xffffffff>;

		__overlay__ {
			interrupt-parent = <0xffffffff>;
			interrupts = <0x90 0x04 0x90 0x01>;
			status = "okay";
		};
	};

	fragment@76 {
		target = <0xffffffff>;

		__overlay__ {
			compatible = "mediatek,md1_sim1_hot_plug_eint-eint";
			interrupts = <0x00 0x08>;
			debounce = <0x00 0x2710>;
			dedicated = <0x00 0x00>;
			src_pin = <0x00 0x01>;
			sockettype = <0x00 0x00>;
			status = "okay";
		};
	};

	fragment@77 {
		target = <0xffffffff>;

		__overlay__ {
			regulator-name = "vcama";
			regulator-default-on = <0x01>;
			status = "okay";
		};
	};

	fragment@78 {
		target = <0xffffffff>;

		__overlay__ {
			regulator-name = "vsim1";
			regulator-default-on = <0x01>;
			status = "okay";
		};
	};

	fragment@79 {
		target = <0xffffffff>;

		__overlay__ {
			regulator-name = "vsim2";
			regulator-default-on = <0x01>;
			status = "okay";
		};
	};

	fragment@80 {
		target = <0xffffffff>;

		__overlay__ {
			regulator-name = "vcamd";
			regulator-default-on = <0x01>;
			status = "okay";
		};
	};

	fragment@81 {
		target = <0xffffffff>;

		__overlay__ {
			regulator-name = "vcamio";
			regulator-default-on = <0x01>;
			status = "okay";
		};
	};

	fragment@82 {
		target = <0xffffffff>;

		__overlay__ {
			regulator-name = "vldo28";
			regulator-default-on = <0x01>;
			status = "okay";
		};
	};

	fragment@83 {
		target = <0xffffffff>;

		__overlay__ {
			vcama-supply = <0xffffffff>;
			vcamd_main2-supply = <0xffffffff>;
			vcamio-supply = <0xffffffff>;
			vcamio_sub-supply = <0xffffffff>;
			vcamio_main2-supply = <0xffffffff>;
			vcamio_main3-supply = <0xffffffff>;
			vcamaf-supply = <0xffffffff>;
			vcamaf_sub-supply = <0xffffffff>;
			vcamaf_main2-supply = <0xffffffff>;
			status = "okay";
		};
	};

	fragment@84 {
		target = <0xffffffff>;

		__overlay__ {
			status = "okay";
		};
	};

	fragment@85 {
		target = <0xffffffff>;

		__overlay__ {
			mediatek,kpd-key-debounce = <0x400>;
			mediatek,kpd-sw-pwrkey = <0x74>;
			mediatek,kpd-hw-pwrkey = <0x08>;
			mediatek,kpd-use-extend-type = <0x00>;
			mediatek,kpd-hw-map-num = <0x48>;
			mediatek,kpd-hw-init-map = <0x73 0x72 0x00 0x00 0x00 0x00 0x00 0x00 0x00 0x00 0x00 0x00 0x00 0x00 0x00 0x00 0x00 0x00 0x00 0x00 0x00 0x00 0x00 0x00 0x00 0x00 0x00 0x00 0x00 0x00 0x00 0x00 0x00 0x00 0x00 0x00 0x00 0x00 0x00 0x00 0x00 0x00 0x00 0x00 0x00 0x00 0x00 0x00 0x00 0x00 0x00 0x00 0x00 0x00 0x00 0x00 0x00 0x00 0x00 0x00 0x00 0x00 0x00 0x00 0x00 0x00 0x00 0x00 0x00 0x00 0x00 0x00>;
			mediatek,kpd-pwrkey-eint-gpio = <0x00>;
			mediatek,kpd-pwkey-gpio-din = <0x00>;
			mediatek,kpd-hw-dl-key0 = <0x00>;
			mediatek,kpd-hw-dl-key1 = <0x01>;
			mediatek,kpd-hw-dl-key2 = <0x08>;
			mediatek,kpd-hw-recovery-key = <0x00>;
			mediatek,kpd-hw-factory-key = <0x01>;
			status = "okay";
		};
	};

	__symbols__ {
		led0 = "/fragment@2/__overlay__/led@0";
		led1 = "/fragment@2/__overlay__/led@1";
		led2 = "/fragment@2/__overlay__/led@2";
		led3 = "/fragment@2/__overlay__/led@3";
		led4 = "/fragment@2/__overlay__/led@4";
		led5 = "/fragment@2/__overlay__/led@5";
		led6 = "/fragment@2/__overlay__/led@6";
		vibrator0 = "/fragment@2/__overlay__/vibrator@0";
		consys_pins_default = "/fragment@5/__overlay__/consys_default";
		gpslna_pins_init = "/fragment@5/__overlay__/gpslna@0";
		gpslna_pins_oh = "/fragment@5/__overlay__/gpslna@1";
		gpslna_pins_ol = "/fragment@5/__overlay__/gpslna@2";
		kpd_pins_default = "/fragment@8/__overlay__/kpdgpiodefault";
		accdet_pins_default = "/fragment@10/__overlay__/accdetdefault";
		accdet_pins_eint_as_int = "/fragment@10/__overlay__/accdeteint@0";
		irtx_gpio_led_default = "/fragment@12/__overlay__/irtx_gpio_led_def@gpio90";
		irtx_gpio_led_set = "/fragment@12/__overlay__/irtx_gpio_led_set@gpio90";
		aud_clk_mosi_off = "/fragment@14/__overlay__/aud_clk_mosi_off";
		aud_clk_mosi_on = "/fragment@14/__overlay__/aud_clk_mosi_on";
		aud_clk_miso_off = "/fragment@14/__overlay__/aud_clk_miso_off";
		aud_clk_miso_on = "/fragment@14/__overlay__/aud_clk_miso_on";
		aud_dat_mosi_off = "/fragment@14/__overlay__/aud_dat_mosi_off";
		aud_dat_mosi_on = "/fragment@14/__overlay__/aud_dat_mosi_on";
		aud_dat_miso_off = "/fragment@14/__overlay__/aud_dat_miso_off";
		aud_dat_miso_on = "/fragment@14/__overlay__/aud_dat_miso_on";
		aud_pins_smartpa_off = "/fragment@14/__overlay__/aud_pins_smartpa_off";
		aud_pins_smartpa_on = "/fragment@14/__overlay__/aud_pins_smartpa_on";
		fps_irq = "/fragment@19/__overlay__/fps_irq";
		fps_reset_high = "/fragment@19/__overlay__/fps_reset_high";
		fps_reset_low = "/fragment@19/__overlay__/fps_reset_low";
		fingerprint_int = "/fragment@20/__overlay__/fingerprint_int";
		goodix_int = "/fragment@20/__overlay__/goodix_int";
		ctp_pins_default = "/fragment@23/__overlay__/eint0default";
		ctp_pins_eint_as_int = "/fragment@23/__overlay__/eint@0";
		ctp_pins_eint_output0 = "/fragment@23/__overlay__/eintoutput0";
		ctp_pins_eint_output1 = "/fragment@23/__overlay__/eintoutput1";
		ctp_pins_rst_output0 = "/fragment@23/__overlay__/rstoutput0";
		ctp_pins_rst_output1 = "/fragment@23/__overlay__/rstoutput1";
		camera_pins_cam0_mclk_on = "/fragment@25/__overlay__/camera_pins_cam0_mclk_on";
		camera_pins_cam0_mclk_off = "/fragment@25/__overlay__/camera_pins_cam0_mclk_off";
		camera_pins_cam1_mclk_on = "/fragment@25/__overlay__/camera_pins_cam1_mclk_on";
		camera_pins_cam1_mclk_off = "/fragment@25/__overlay__/camera_pins_cam1_mclk_off";
		camera_pins_cam2_mclk_on = "/fragment@25/__overlay__/camera_pins_cam2_mclk_on";
		camera_pins_cam2_mclk_off = "/fragment@25/__overlay__/camera_pins_cam2_mclk_off";
		camera_pins_cam4_mclk_on = "/fragment@25/__overlay__/camera_pins_cam4_mclk_on";
		camera_pins_cam4_mclk_off = "/fragment@25/__overlay__/camera_pins_cam4_mclk_off";
		camera_pins_cam0_rst0 = "/fragment@25/__overlay__/cam0@0";
		camera_pins_cam0_rst1 = "/fragment@25/__overlay__/cam0@1";
		camera_pins_cam0_pnd0 = "/fragment@25/__overlay__/cam0@2";
		camera_pins_cam0_pnd1 = "/fragment@25/__overlay__/cam0@3";
		camera_pins_cam1_rst0 = "/fragment@25/__overlay__/cam1@0";
		camera_pins_cam1_rst1 = "/fragment@25/__overlay__/cam1@1";
		camera_pins_cam1_pnd0 = "/fragment@25/__overlay__/cam1@2";
		camera_pins_cam1_pnd1 = "/fragment@25/__overlay__/cam1@3";
		camera_pins_cam2_rst0 = "/fragment@25/__overlay__/cam2@0";
		camera_pins_cam2_rst1 = "/fragment@25/__overlay__/cam2@1";
		camera_pins_cam2_pnd0 = "/fragment@25/__overlay__/cam2@2";
		camera_pins_cam2_pnd1 = "/fragment@25/__overlay__/cam2@3";
		camera_pins_cam4_rst0 = "/fragment@25/__overlay__/cam4@0";
		camera_pins_cam4_rst1 = "/fragment@25/__overlay__/cam4@1";
		camera_pins_cam_ldo_rear_vcama_0 = "/fragment@25/__overlay__/cam0@vcama0";
		camera_pins_cam_ldo_rear_vcama_1 = "/fragment@25/__overlay__/cam0@vcama1";
		camera_pins_cam_ldo_rear_vcamd_0 = "/fragment@25/__overlay__/cam0@vcamd0";
		camera_pins_cam_ldo_rear_vcamd_1 = "/fragment@25/__overlay__/cam0@vcamd1";
		camera_pins_cam_ldo_sub_vcama_0 = "/fragment@25/__overlay__/cam1@vcama0";
		camera_pins_cam_ldo_sub_vcama_1 = "/fragment@25/__overlay__/cam1@vcama1";
		camera_pins_cam_ldo_rear2_vcama_0 = "/fragment@25/__overlay__/cam2@vcama0";
		camera_pins_cam_ldo_rear2_vcama_1 = "/fragment@25/__overlay__/cam2@vcama1";
		camera_pins_cam_ldo_rear3_vcama_0 = "/fragment@25/__overlay__/cam4@vcama0";
		camera_pins_cam_ldo_rear3_vcama_1 = "/fragment@25/__overlay__/cam4@vcama1";
		camera_pins_default = "/fragment@25/__overlay__/camdefault";
		flash_default = "/fragment@27/__overlay__/flash_default_cfg";
		flash_en_pin0 = "/fragment@27/__overlay__/flash_en_pin0";
		flash_en_pin1 = "/fragment@27/__overlay__/flash_en_pin1";
		torch_en_pin0 = "/fragment@27/__overlay__/torch_en_pin0";
		torch_en_pin1 = "/fragment@27/__overlay__/torch_en_pin1";
		bq2560x_charger = "/fragment@37/__overlay__/bq25601@6B";
		sgm41513_charger = "/fragment@37/__overlay__/bq25601@1A";
		led7 = "/fragment@46/__overlay__/led@7";
		usb_phy_init = "/fragment@46/__overlay__/usb_phy_init";
		mtkfb_pins_lcm_reset0 = "/fragment@47/__overlay__/lcm_rst_out0_gpio";
		mtkfb_pins_lcm_reset1 = "/fragment@47/__overlay__/lcm_rst_out1_gpio";
		mtkfb_pins_lcd_bias_enp0 = "/fragment@47/__overlay__/lcd_bias_enp0_gpio";
		mtkfb_pins_lcd_bias_enp1 = "/fragment@47/__overlay__/lcd_bias_enp1_gpio";
		mtkfb_pins_lcd_bias_enn0 = "/fragment@47/__overlay__/lcd_bias_enn0_gpio";
		mtkfb_pins_lcd_bias_enn1 = "/fragment@47/__overlay__/lcd_bias_enn1_gpio";
		mtkfb_pins_lcm_pwr_en_out0 = "/fragment@47/__overlay__/lcm_pwr_en_out0_gpio";
		mtkfb_pins_lcm_pwr_en_out1 = "/fragment@47/__overlay__/lcm_pwr_en_out1_gpio";
		mtkfb_pins_default = "/fragment@47/__overlay__/dispdefault";
		i2c_lcd_bias_mtk = "/fragment@55/__overlay__/i2c_lcd_bias@3e";
		camera_main_mtk = "/fragment@57/__overlay__/camera_main@40";
		camera_main_eeprom_mtk = "/fragment@57/__overlay__/camera_main_eeprom@50";
		camera_main_af_mtk = "/fragment@57/__overlay__/camera_main_af@18";
		ccu_sensor_i2c_2_hw_mtk = "/fragment@57/__overlay__/ccu_sensor_i2c_2_hw@10";
		camera_main_three_mtk = "/fragment@57/__overlay__/camera_main_three@6e";
		speaker_amp_mtk = "/fragment@58/__overlay__/speaker_amp@34";
		slave_charger_mtk = "/fragment@58/__overlay__/slave_charger@4b";
		nfc_mtk = "/fragment@58/__overlay__/nfc@08";
		ext_buck_lp4_mtk = "/fragment@58/__overlay__/ext_buck_lp4@57";
		ext_buck_lp4x_mtk = "/fragment@58/__overlay__/ext_buck_lp4x@50";
		camera_main_two_mtk = "/fragment@59/__overlay__/camera_main_two@7a";
		camera_main_two_eeprom_mtk = "/fragment@59/__overlay__/camera_main_two_eeprom@50";
		camera_sub_mtk = "/fragment@59/__overlay__/camera_sub@2d";
		camera_sub_eeprom_mtk = "/fragment@59/__overlay__/camera_sub_eeprom@54";
		ccu_sensor_i2c_4_hw_mtk = "/fragment@59/__overlay__/ccu_sensor_i2c_4_hw@11";
		subpmic_pmu_mtk = "/fragment@60/__overlay__/subpmic_pmu@34";
		usb_type_c_mtk = "/fragment@60/__overlay__/usb_type_c@4e";
		usb_type_c_sgm_mtk = "/fragment@60/__overlay__/usb_type_c_sgm@47";
		camera_main_two_af_mtk = "/fragment@61/__overlay__/camera_main_two_af@0c";
		ext_buck_vgpu_mtk = "/fragment@61/__overlay__/ext_buck_vgpu@55";
	};

	__fixups__ {
		odm = "/fragment@0:target:0\0/fragment@2:target:0\0/fragment@20:target:0\0/fragment@46:target:0";
		chosen = "/fragment@1:target:0";
		i2c3 = "/fragment@3:target:0\0/fragment@58:target:0";
		i2c6 = "/fragment@4:target:0\0/fragment@61:target:0";
		mt_pmic_vio28_ldo_reg = "/fragment@4/__overlay__/abov_sar@20:cap_vdd-supply:0";
		pio = "/fragment@4/__overlay__/abov_sar@20:interrupt-parent:0\0/fragment@4/__overlay__/abov_sar@20:abov,irq-gpio-std:0\0/fragment@5:target:0\0/fragment@8:target:0\0/fragment@10:target:0\0/fragment@12:target:0\0/fragment@14:target:0\0/fragment@15/__overlay__:mt6370,intr_gpio:0\0/fragment@16/__overlay__:mt6370pd,intr_gpio:0\0/fragment@19:target:0\0/fragment@20/__overlay__/fingerprint_int:interrupt-parent:0\0/fragment@20/__overlay__/fingerprint_int:fpc,rst:0\0/fragment@20/__overlay__/fingerprint_int:fpc,irq:0\0/fragment@20/__overlay__/goodix_int:interrupt-parent:0\0/fragment@20/__overlay__/goodix_int:int-gpios:0\0/fragment@23:target:0\0/fragment@24/__overlay__/touch@0:novatek,reset-gpio:0\0/fragment@24/__overlay__/touch@0:novatek,irq-gpio:0\0/fragment@24/__overlay__/touch@0:touch,reset-gpio:0\0/fragment@24/__overlay__/touch@0:touch,irq-gpio:0\0/fragment@24/__overlay__/touch@0:chipone,rst-gpio:0\0/fragment@24/__overlay__/touch@0:chipone,irq-gpio:0\0/fragment@25:target:0\0/fragment@27:target:0\0/fragment@47:target:0\0/fragment@65/__overlay__:GPIO_SIM2_SIO:0\0/fragment@65/__overlay__:GPIO_SIM2_SRST:0\0/fragment@65/__overlay__:GPIO_SIM2_SCLK:0\0/fragment@65/__overlay__:GPIO_SIM1_SCLK:0\0/fragment@65/__overlay__:GPIO_SIM1_SRST:0\0/fragment@65/__overlay__:GPIO_SIM1_SIO:0\0/fragment@65/__overlay__:GPIO_SIM1_HOT_PLUG:0\0/fragment@67/__overlay__:interrupt-parent:0\0/fragment@68/__overlay__:interrupt-parent:0\0/fragment@68/__overlay__:deb-gpios:0\0/fragment@69/__overlay__:interrupt-parent:0\0/fragment@70/__overlay__:interrupt-parent:0\0/fragment@71/__overlay__:interrupt-parent:0\0/fragment@72/__overlay__:interrupt-parent:0\0/fragment@73/__overlay__:interrupt-parent:0\0/fragment@74/__overlay__:interrupt-parent:0\0/fragment@74/__overlay__:deb-gpios:0\0/fragment@75/__overlay__:interrupt-parent:0";
		consys = "/fragment@6:target:0";
		keypad = "/fragment@7:target:0\0/fragment@85:target:0";
		accdet = "/fragment@9:target:0";
		irtx_pwm = "/fragment@11:target:0";
		audgpio = "/fragment@13:target:0";
		mt6370_pmu = "/fragment@15:target:0";
		mt6370_typec = "/fragment@16:target:0";
		mt6370_chg = "/fragment@17:target:0\0/fragment@31:target:0";
		lk_charger = "/fragment@18:target:0\0/fragment@39:target:0";
		spi1 = "/fragment@21:target:0";
		touch = "/fragment@22:target:0\0/fragment@69:target:0\0/fragment@84:target:0";
		spi3 = "/fragment@24:target:0";
		kd_camera_hw1 = "/fragment@26:target:0\0/fragment@83:target:0";
		mt_pmic_vcamio_ldo_reg = "/fragment@26/__overlay__:cam0_vcamio-supply:0\0/fragment@26/__overlay__:cam1_vcamio-supply:0\0/fragment@26/__overlay__:cam2_vcamio-supply:0\0/fragment@26/__overlay__:cam4_vcamio-supply:0\0/fragment@81:target:0\0/fragment@83/__overlay__:vcamio-supply:0\0/fragment@83/__overlay__:vcamio_sub-supply:0\0/fragment@83/__overlay__:vcamio_main2-supply:0\0/fragment@83/__overlay__:vcamio_main3-supply:0";
		mt_pmic_vcamd_ldo_reg = "/fragment@26/__overlay__:cam1_vcamd-supply:0\0/fragment@80:target:0\0/fragment@83/__overlay__:vcamd_main2-supply:0";
		mt_pmic_vcama_ldo_reg = "/fragment@26/__overlay__:cam2_vcama-supply:0\0/fragment@77:target:0\0/fragment@83/__overlay__:vcama-supply:0";
		flashlights_ocp8132 = "/fragment@28:target:0";
		camera_af_hw_node = "/fragment@29:target:0";
		mt_pmic_vldo28_ldo_reg = "/fragment@29/__overlay__:camaf_m1_pmic-supply:0\0/fragment@82:target:0\0/fragment@83/__overlay__:vcamaf-supply:0\0/fragment@83/__overlay__:vcamaf_sub-supply:0\0/fragment@83/__overlay__:vcamaf_main2-supply:0";
		mtk_charger_type = "/fragment@30:target:0\0/fragment@32/__overlay__:charger:0\0/fragment@43/__overlay__:charger:0\0/fragment@44/__overlay__:charger:0";
		usb = "/fragment@32:target:0";
		tboard_thermistor1 = "/fragment@33:target:0";
		auxadc = "/fragment@33/__overlay__:io-channels:0\0/fragment@33/__overlay__:interconnects:0\0/fragment@34/__overlay__:io-channels:0\0/fragment@34/__overlay__:interconnects:0\0/fragment@35/__overlay__:io-channels:0\0/fragment@35/__overlay__:interconnects:0\0/fragment@36/__overlay__:io-channels:0\0/fragment@36/__overlay__:interconnects:0\0/fragment@52:target:0\0/fragment@53/__overlay__:io-channels:0";
		tboard_thermistor2 = "/fragment@34:target:0";
		tboard_thermistor3 = "/fragment@35:target:0";
		tboard_thermistor4 = "/fragment@36:target:0";
		i2c5 = "/fragment@37:target:0\0/fragment@60:target:0";
		pdc = "/fragment@38:target:0";
		pe = "/fragment@40:target:0";
		pe2 = "/fragment@41:target:0";
		pe4 = "/fragment@42:target:0";
		charger = "/fragment@43:target:0";
		mtk_gauge = "/fragment@44:target:0";
		moto_chg_tcmd = "/fragment@45:target:0";
		mtkfb = "/fragment@48:target:0";
		i2c0 = "/fragment@49:target:0\0/fragment@55:target:0";
		regulator_vibrator = "/fragment@50:target:0";
		msdc1 = "/fragment@51:target:0";
		md_auxadc = "/fragment@53:target:0";
		pmic_clock_buffer_ctrl = "/fragment@54:target:0";
		i2c1 = "/fragment@56:target:0";
		i2c2 = "/fragment@57:target:0";
		i2c4 = "/fragment@59:target:0";
		i2c7 = "/fragment@62:target:0";
		i2c8 = "/fragment@63:target:0";
		i2c9 = "/fragment@64:target:0";
		gpio_usage_mapping = "/fragment@65:target:0";
		gpio = "/fragment@66:target:0";
		msdc1_ins = "/fragment@67:target:0";
		mrdump_ext_rst = "/fragment@68:target:0";
		subpmic_pmu_eint = "/fragment@70:target:0";
		goodix_fp = "/fragment@71:target:0";
		tcpc_pd = "/fragment@72:target:0";
		dsi_te = "/fragment@73:target:0";
		swtp = "/fragment@74:target:0";
		main_pmic = "/fragment@75:target:0";
		md1_sim1_hot_plug_eint = "/fragment@76:target:0";
		mt_pmic_vsim1_ldo_reg = "/fragment@78:target:0";
		mt_pmic_vsim2_ldo_reg = "/fragment@79:target:0";
	};

	__local_fixups__ {

		fragment@6 {

			__overlay__ {
				pinctrl-0 = <0x00>;
				pinctrl-1 = <0x00>;
				pinctrl-2 = <0x00>;
				pinctrl-3 = <0x00>;
			};
		};

		fragment@7 {

			__overlay__ {
				pinctrl-0 = <0x00>;
			};
		};

		fragment@9 {

			__overlay__ {
				pinctrl-0 = <0x00>;
				pinctrl-1 = <0x00>;
			};
		};

		fragment@11 {

			__overlay__ {
				pinctrl-0 = <0x00>;
				pinctrl-1 = <0x00>;
			};
		};

		fragment@13 {

			__overlay__ {
				pinctrl-0 = <0x00>;
				pinctrl-1 = <0x00>;
				pinctrl-2 = <0x00>;
				pinctrl-3 = <0x00>;
				pinctrl-4 = <0x00>;
				pinctrl-5 = <0x00>;
				pinctrl-6 = <0x00>;
				pinctrl-7 = <0x00>;
				pinctrl-8 = <0x00>;
				pinctrl-9 = <0x00>;
			};
		};

		fragment@20 {

			__overlay__ {

				fingerprint_int {
					pinctrl-0 = <0x00>;
					pinctrl-1 = <0x00>;
					pinctrl-2 = <0x00>;
				};

				goodix_int {
					pinctrl-0 = <0x00>;
					pinctrl-1 = <0x00>;
					pinctrl-2 = <0x00>;
				};
			};
		};

		fragment@22 {

			__overlay__ {
				pinctrl-0 = <0x00>;
				pinctrl-1 = <0x00>;
				pinctrl-2 = <0x00>;
				pinctrl-3 = <0x00>;
				pinctrl-4 = <0x00>;
				pinctrl-5 = <0x00>;
			};
		};

		fragment@26 {

			__overlay__ {
				pinctrl-0 = <0x00>;
				pinctrl-1 = <0x00>;
				pinctrl-2 = <0x00>;
				pinctrl-3 = <0x00>;
				pinctrl-4 = <0x00>;
				pinctrl-5 = <0x00>;
				pinctrl-6 = <0x00>;
				pinctrl-7 = <0x00>;
				pinctrl-8 = <0x00>;
				pinctrl-9 = <0x00>;
				pinctrl-10 = <0x00>;
				pinctrl-11 = <0x00>;
				pinctrl-12 = <0x00>;
				pinctrl-13 = <0x00>;
				pinctrl-14 = <0x00>;
				pinctrl-15 = <0x00>;
				pinctrl-16 = <0x00>;
				pinctrl-17 = <0x00>;
				pinctrl-18 = <0x00>;
				pinctrl-19 = <0x00>;
				pinctrl-20 = <0x00>;
				pinctrl-21 = <0x00>;
				pinctrl-22 = <0x00>;
				pinctrl-23 = <0x00>;
				pinctrl-24 = <0x00>;
				pinctrl-25 = <0x00>;
				pinctrl-26 = <0x00>;
				pinctrl-27 = <0x00>;
				pinctrl-28 = <0x00>;
				pinctrl-29 = <0x00>;
				pinctrl-30 = <0x00>;
				pinctrl-31 = <0x00>;
				pinctrl-32 = <0x00>;
			};
		};

		fragment@28 {

			__overlay__ {
				pinctrl-0 = <0x00>;
				pinctrl-1 = <0x00>;
				pinctrl-2 = <0x00>;
				pinctrl-3 = <0x00>;
				pinctrl-4 = <0x00>;
			};
		};

		fragment@44 {

			__overlay__ {
				extern_charger = <0x00>;
				extern_charger_sgm41513 = <0x00>;
			};
		};

		fragment@48 {

			__overlay__ {
				pinctrl-0 = <0x00>;
				pinctrl-1 = <0x00>;
				pinctrl-2 = <0x00>;
				pinctrl-3 = <0x00>;
				pinctrl-4 = <0x00>;
				pinctrl-5 = <0x00>;
				pinctrl-6 = <0x00>;
				pinctrl-7 = <0x00>;
				pinctrl-8 = <0x00>;
			};
		};
	};
};
